## CMakeLists.txt
```
# SPDX-License-Identifier: Apache-2.0
cmake_minimum_required(VERSION 3.20.0)

list(APPEND BOARD_ROOT ${CMAKE_CURRENT_LIST_DIR}/..)

find_package(Zephyr REQUIRED HINTS $ENV{ZEPHYR_BASE})
project(fiber_southbridge_app)

# VERSION: south-zephyr <SB_FW_VERSION> g<SB_GIT_SHA>. The Hub compares it with the manifest
# of the image it carries and re-flashes the SB on a mismatch
# (proximos-v2 plan/system/southbridge_update.md §3.1).
set(SB_FW_VERSION "1.1.0")

# The last commit that touched what goes into the image (app/, boards/, west.yml), taken when
# CMake configures (a pristine build re-reads it). Path-scoped, not HEAD, so a Hub-only commit
# of the monorepo, or one to the SB docs, tests or tools, does not change the identity and
# re-flashes no SB. A shallow clone may answer with its boundary commit: the CI fetches full
# history for it (GIT_DEPTH 0). 00000000 when this is not a git checkout.
execute_process(
  COMMAND git log -1 --format=%H -- app boards west.yml
  WORKING_DIRECTORY ${CMAKE_CURRENT_LIST_DIR}/..
  OUTPUT_VARIABLE SB_GIT_SHA
  OUTPUT_STRIP_TRAILING_WHITESPACE
  ERROR_QUIET
  RESULT_VARIABLE sb_git_rc)
if(NOT sb_git_rc EQUAL 0 OR NOT SB_GIT_SHA MATCHES "^[0-9a-f]+$")
  set(SB_GIT_SHA "00000000")
endif()
string(SUBSTRING "${SB_GIT_SHA}00000000" 0 8 SB_GIT_SHA)
target_compile_definitions(app PRIVATE
  SB_FW_VERSION_STR="${SB_FW_VERSION}"
  SB_GIT_SHA_STR="${SB_GIT_SHA}"
)
# Read by tools/sb_package.py (through system/scripts/sb-package.sh) to write the manifest of
# exactly this build.
file(WRITE ${CMAKE_BINARY_DIR}/zephyr/sb_build.json
  "{\"fw_version\": \"${SB_FW_VERSION}\", \"git_sha\": \"${SB_GIT_SHA}\"}\n")

target_sources(app PRIVATE
	src/main.c
	src/gpio_table.c
	src/uart_proto.c
	src/cmd_dispatch.c
	src/adc_read.c
	src/led_pwm.c
	src/shell_cmds.c
)
```

## prj.conf
```kconfig
# Drivers
CONFIG_GPIO=y
CONFIG_SERIAL=y
CONFIG_UART_INTERRUPT_DRIVEN=y
CONFIG_ADC=y

# USART1 stays exclusive to the application protocol parser
CONFIG_UART_CONSOLE=n

# Segger RTT debug channel via SWD (J-Link)
CONFIG_USE_SEGGER_RTT=y
CONFIG_CONSOLE=n
CONFIG_PRINTK=n

# Zephyr shell on RTT — minimal config to fit STM32C031C6 32 KB flash
CONFIG_SHELL=y
CONFIG_SHELL_MINIMAL=y
CONFIG_SHELL_BACKEND_RTT=y
CONFIG_SHELL_BACKEND_SERIAL=n
CONFIG_SHELL_PROMPT_RTT="south:~$ "
CONFIG_SHELL_STACK_SIZE=2048
CONFIG_SHELL_CMD_BUFF_SIZE=64
CONFIG_SHELL_PRINTF_BUFF_SIZE=64

# Don't echo input — terminal client (rttt / JLinkRTTClient) echoes locally,
# so leaving shell echo on causes double-character display.
CONFIG_SHELL_ECHO_STATUS=n
CONFIG_SHELL_RTT_RX_POLL_PERIOD=50

# No log subsystem — too heavy for 32 KB flash. Use direct uart_proto for
# protocol responses and shell printk for RTT-side diagnostics.
CONFIG_LOG=n

# Picolibc — IO_INTEGER strips floating point from printf/scanf (we never
# format floats; ADC math is integer-only). Saves ~3 KB flash vs default.
CONFIG_PICOLIBC=y
CONFIG_PICOLIBC_IO_MINIMAL=y

# Stack
CONFIG_MAIN_STACK_SIZE=2048
CONFIG_ISR_STACK_SIZE=1024

# 1 kHz system tick. A 10 kHz tick rate had the SysTick handler servicing
# enough timeouts per second that USART1 RX bytes got dropped (overrun)
# at 115200 baud (87 µs/byte). With 1 kHz, the timeout pressure drops 10×
# and the UART RX IRQ has enough headroom to service every byte.
CONFIG_SYS_CLOCK_TICKS_PER_SEC=1000

# Squeeze flash
CONFIG_SIZE_OPTIMIZATIONS=y
# LTO disabled — was eliding pwm_tick callback referenced only by
# Z_TIMER_INITIALIZER (a static initializer), causing the soft-PWM ISR to
# never fire.
CONFIG_LTO=n
```

## src/main.c
```c
/* SPDX-License-Identifier: Apache-2.0 */
#include "proto.h"
#include "gpio_table.h"
#include "uart_proto.h"
#include "adc_read.h"
#include "led_pwm.h"

#include <zephyr/kernel.h>
#include <zephyr/sys/printk.h>

/* Visual fault indicator: flash all red LEDs forever. Used when an init step
 * returns a hard failure — gives a physical signal in lieu of UART/RTT (which
 * may both be down). The caller is expected to printk() the specifics first. */
static void fault_blink(void)
{
	for (;;) {
		for (uint8_t i = 0; i < LED_COUNT; i++) {
			gpio_table_set(gpio_table_led_red(i), true);
		}
		k_msleep(200);
		for (uint8_t i = 0; i < LED_COUNT; i++) {
			gpio_table_set(gpio_table_led_red(i), false);
		}
		k_msleep(200);
	}
}

static void startup_animation(void)
{
	gpio_table_set(gpio_table_pwr_yellow(), true);

	for (uint8_t i = 0; i < LED_COUNT; i++) {
		gpio_table_set(gpio_table_led_green(i), true);
		k_msleep(125);
	}
	k_msleep(500);

	for (uint8_t i = 0; i < LED_COUNT; i++) {
		gpio_table_set(gpio_table_led_green(i), false);
	}
	gpio_table_set(gpio_table_pwr_yellow(), false);
}

int main(void)
{
	int rc;

	printk("south-zephyr boot\n");

	rc = gpio_table_init();
	if (rc < 0) {
		printk("gpio_table_init failed: %d\n", rc);
	}

	startup_animation();   /* run before any UART/ADC dependence on those */

	rc = uart_proto_init();
	if (rc < 0) {
		printk("uart_proto_init failed: %d\n", rc);
		/* Stay alive with a visible fault pattern so we never hang
		 * silently in uart_poll_out below. */
		fault_blink();
	}

	rc = adc_read_init();
	if (rc < 0) {
		printk("adc_read_init failed: %d\n", rc);
		/* Not fatal for the protocol path — just warn. */
	}

	rc = led_pwm_init();
	if (rc < 0) {
		printk("led_pwm_init failed: %d\n", rc);
	}
	led_pwm_start();

	printk("south-zephyr ready\n");
	uart_proto_write("GPIO UART control ready\r\n");
	uart_proto_write("Use: P0 ON, P7 TOGGLE, LED3G OFF, LED7R ON, VIN READ, VBAT READ\r\n");

	for (;;) {
		uart_proto_poll();
		k_msleep(1);
	}
	return 0;
}
```

## src/adc_read.c
```c
/* SPDX-License-Identifier: Apache-2.0 */
#include "adc_read.h"
#include "uart_proto.h"

#include <errno.h>
#include <string.h>
#include <stdio.h>
#include <zephyr/devicetree.h>
#include <zephyr/drivers/adc.h>

#define ADC_USER_NODE DT_PATH(zephyr_user)

static const struct adc_dt_spec adc_vbat = ADC_DT_SPEC_GET_BY_IDX(ADC_USER_NODE, 0);
static const struct adc_dt_spec adc_vin  = ADC_DT_SPEC_GET_BY_IDX(ADC_USER_NODE, 1);

static int read_raw(const struct adc_dt_spec *spec, uint16_t *raw_out)
{
	int16_t sample = 0;
	struct adc_sequence seq = {
		.buffer = &sample,
		.buffer_size = sizeof(sample),
	};

	int rc = adc_sequence_init_dt(spec, &seq);
	if (rc < 0) {
		return rc;
	}

	rc = adc_read(spec->dev, &seq);
	if (rc < 0) {
		return rc;
	}

	*raw_out = (uint16_t)sample;
	return 0;
}

int adc_read_init(void)
{
	if (!adc_is_ready_dt(&adc_vbat) || !adc_is_ready_dt(&adc_vin)) {
		return -ENODEV;
	}

	int rc = adc_channel_setup_dt(&adc_vbat);
	if (rc < 0) {
		return rc;
	}
	rc = adc_channel_setup_dt(&adc_vin);
	if (rc < 0) {
		return rc;
	}
	return 0;
}

int adc_read_print(const char *channel_name)
{
	const struct adc_dt_spec *spec;
	bool is_vin;

	if (strcmp(channel_name, "VIN") == 0) {
		spec = &adc_vin;
		is_vin = true;
	} else if (strcmp(channel_name, "VBAT") == 0) {
		spec = &adc_vbat;
		is_vin = false;
	} else {
		uart_proto_write("ERR: unknown ADC name (use VIN or VBAT)\r\n");
		return -EINVAL;
	}

	uint16_t raw = 0;
	int rc = read_raw(spec, &raw);
	if (rc < 0) {
		uart_proto_write("ERR: adc read failed\r\n");
		return rc;
	}

	/* Pin voltage in mV: raw * 3300 / 4095 (integer, matches legacy). */
	int32_t v_pin_mv = (int32_t)raw * 3300 / 4095;
	/* Real voltage after divider:
	 *   VIN  = v_pin * 398 / 68    ≈ (330k+68k)/68k = 5.85
	 *   VBAT = v_pin * 2           = (68k+68k)/68k  = 2.0
	 */
	int32_t v_real_mv = is_vin ? (v_pin_mv * 398 / 68) : (v_pin_mv * 2);

	char buf[96];
	int n = snprintf(buf, sizeof(buf),
			 "%s_raw=%u  %s_pin=%ldmV  %s=%ldmV\r\n",
			 channel_name, (unsigned)raw,
			 channel_name, (long)v_pin_mv,
			 channel_name, (long)v_real_mv);
	if (n > 0) {
		uart_proto_write_bytes(buf, (size_t)n);
	}
	return 0;
}
```

## src/adc_read.h
```c
/* SPDX-License-Identifier: Apache-2.0 */
#ifndef APP_ADC_READ_H_
#define APP_ADC_READ_H_

#include <stdint.h>

int adc_read_init(void);

/* Reads one shot from VIN or VBAT, emits the formatted line via
 * uart_proto_write(). Returns 0 on success.
 * channel_name must be "VIN" or "VBAT".
 */
int adc_read_print(const char *channel_name);

#endif /* APP_ADC_READ_H_ */
```

## src/cmd_dispatch.c
```c
/* SPDX-License-Identifier: Apache-2.0 */
#include "cmd_dispatch.h"
#include "proto.h"
#include "uart_proto.h"
#include "gpio_table.h"
#include "adc_read.h"
#include "led_pwm.h"

#include <string.h>
#include <stdio.h>      /* snprintf for STATUS/UPTIME output */
#include <stdlib.h>
#include <zephyr/kernel.h>

static uint8_t map_led_color(char c)
{
	switch (c) {
	case 'G': case 'g': return LED_COLOR_GREEN;
	case 'R': case 'r': return LED_COLOR_RED;
	case 'Y': case 'y': return LED_COLOR_YELLOW;
	default:            return LED_COLOR_OFF;
	}
}

static uint8_t map_pwr_color(char c)
{
	switch (c) {
	case 'G': case 'g': return PWR_COLOR_GREEN;
	case 'Y': case 'y': return PWR_COLOR_YELLOW;
	case 'L': case 'l': return PWR_COLOR_LIME;
	default:            return PWR_COLOR_OFF;
	}
}

static uint8_t map_pattern(char c)
{
	switch (c) {
	case 'L': case 'l': return BLINK_SLOW;
	case 'F': case 'f': return BLINK_FAST;
	default:            return BLINK_STEADY;
	}
}

static int parse_uint(const char *s, unsigned int *out)
{
	if (!*s) {
		return -1;
	}
	char *end = NULL;
	unsigned long v = strtoul(s, &end, 10);
	if (end == s || *end != '\0') {
		return -1;
	}
	*out = (unsigned int)v;
	return 0;
}

static const char *skip_ws(const char *p)
{
	while (*p == ' ' || *p == '\t') p++;
	return p;
}

static size_t copy_token(char *dst, size_t dstsz, const char **pp)
{
	const char *p = *pp;
	size_t n = 0;
	while (*p && *p != ' ' && *p != '\t' && n + 1 < dstsz) {
		dst[n++] = *p++;
	}
	dst[n] = '\0';
	*pp = p;
	return n;
}

static void handle_led_cmd(const char *line)
{
	/* Expect "LED <uint> <colorchar> <patternchar>". */
	const char *p = skip_ws(line + 3);  /* past "LED" */
	if (*p < '0' || *p > '9') {
		uart_proto_write("ERR: use LED <0-7> <O|G|R|Y> <S|L|F>\r\n");
		return;
	}
	unsigned int idx = 0;
	while (*p >= '0' && *p <= '9') {
		idx = idx * 10 + (unsigned)(*p - '0');
		p++;
	}
	if (idx >= LED_COUNT) {
		uart_proto_write("ERR: LED index must be 0-7\r\n");
		return;
	}
	p = skip_ws(p);
	char color_c = *p ? *p : 'O';
	while (*p && *p != ' ' && *p != '\t') p++;
	p = skip_ws(p);
	char pattern_c = *p ? *p : 'S';

	led_pwm_set_led((uint8_t)idx, map_led_color(color_c),
			map_pattern(pattern_c));
	uart_proto_write("OK\r\n");
}

static void handle_pwr_cmd(const char *line)
{
	/* Expect "PWR <colorchar> <patternchar>". */
	const char *p = skip_ws(line + 3);  /* past "PWR" */
	if (*p == '\0') {
		uart_proto_write("ERR: use PWR <O|G|Y|L> <S|L|F>\r\n");
		return;
	}
	char color_c = *p;
	while (*p && *p != ' ' && *p != '\t') p++;
	p = skip_ws(p);
	char pattern_c = *p ? *p : 'S';

	led_pwm_set_pwr(map_pwr_color(color_c), map_pattern(pattern_c));
	uart_proto_write("OK\r\n");
}

static void handle_bright_cmd(const char *action)
{
	unsigned int val;
	if (parse_uint(action, &val) < 0) {
		uart_proto_write("ERR: invalid brightness value\r\n");
		return;
	}
	if (val > 100) val = 100;
	led_pwm_set_brightness((uint8_t)val);
	uart_proto_write("OK\r\n");
}

static char color_char_for_line(uint8_t c)
{
	switch (c) {
	case LED_COLOR_GREEN:  return 'G';
	case LED_COLOR_RED:    return 'R';
	case LED_COLOR_YELLOW: return 'Y';
	default:               return 'O';
	}
}

static char color_char_for_pwr(uint8_t c)
{
	switch (c) {
	case PWR_COLOR_GREEN:  return 'G';
	case PWR_COLOR_YELLOW: return 'Y';
	case PWR_COLOR_LIME:   return 'L';
	default:               return 'O';
	}
}

static char pattern_char(uint8_t p)
{
	switch (p) {
	case BLINK_SLOW: return 'L';
	case BLINK_FAST: return 'F';
	default:         return 'S';
	}
}

static void handle_help_cmd(void)
{
	static const char help[] =
		"HELP: P<0-7> ON|OFF|TOGGLE       drive output pin\r\n"
		"HELP: LED<i><G|R> ON|OFF|TOGGLE  drive a single LED pin directly\r\n"
		"HELP: PWRLEDG|PWRLEDY ON|OFF|TOGGLE\r\n"
		"HELP: LED <0-7> <O|G|R|Y> <S|L|F>  composed line LED\r\n"
		"HELP: PWR <O|G|Y|L> <S|L|F>        composed power LED\r\n"
		"HELP: BRIGHT <0-100>             global LED brightness\r\n"
		"HELP: VIN READ | VBAT READ        ADC sample\r\n"
		"HELP: SYNC                       reset blink phase\r\n"
		"HELP: STATUS | VERSION | UPTIME  diagnostics\r\n";
	uart_proto_write(help);
}

static void handle_version_cmd(void)
{
	uart_proto_write("VERSION: " FIRMWARE_VERSION "\r\n");
}

static void handle_uptime_cmd(void)
{
	char buf[48];
	int n = snprintf(buf, sizeof(buf), "UPTIME: %lldms\r\n",
			 (long long)k_uptime_get());
	if (n > 0) {
		uart_proto_write_bytes(buf, (size_t)n);
	}
}

static void handle_status_cmd(void)
{
	char buf[64];
	int n = snprintf(buf, sizeof(buf), "STATUS: brightness=%u\r\n",
			 (unsigned)led_pwm_get_brightness());
	if (n > 0) {
		uart_proto_write_bytes(buf, (size_t)n);
	}

	for (uint8_t i = 0; i < LED_COUNT; i++) {
		uint8_t color, pattern;
		led_pwm_get_led(i, &color, &pattern);
		n = snprintf(buf, sizeof(buf), "STATUS: led%u=%c,%c\r\n",
			     i, color_char_for_line(color),
			     pattern_char(pattern));
		if (n > 0) {
			uart_proto_write_bytes(buf, (size_t)n);
		}
	}

	uint8_t pcolor, ppattern;
	led_pwm_get_pwr(&pcolor, &ppattern);
	n = snprintf(buf, sizeof(buf), "STATUS: pwr=%c,%c\r\n",
		     color_char_for_pwr(pcolor), pattern_char(ppattern));
	if (n > 0) {
		uart_proto_write_bytes(buf, (size_t)n);
	}
}

static void handle_gpio_cmd(const char *name, const char *action)
{
	const struct gpio_entry *e = gpio_table_lookup(name);
	if (!e) {
		uart_proto_write("ERR: unknown GPIO name\r\n");
		return;
	}
	if (strcmp(action, "ON") == 0) {
		gpio_table_set(e, true);
	} else if (strcmp(action, "OFF") == 0) {
		gpio_table_set(e, false);
	} else if (strcmp(action, "TOGGLE") == 0) {
		gpio_table_toggle(e);
	} else {
		uart_proto_write("ERR: unknown action (use ON/OFF/TOGGLE)\r\n");
		return;
	}
	uart_proto_write("OK\r\n");
}

void dispatch_line(char *line)
{
	char name[16];
	char action[16];

	const char *p = skip_ws(line);
	copy_token(name, sizeof(name), &p);
	p = skip_ws(p);
	copy_token(action, sizeof(action), &p);

	/* Single-token commands */
	if (strcmp(name, "SYNC") == 0) {
		led_pwm_sync();
		uart_proto_write("OK\r\n");
		return;
	}
	if (strcmp(name, "HELP") == 0) {
		handle_help_cmd();
		return;
	}
	if (strcmp(name, "VERSION") == 0) {
		handle_version_cmd();
		return;
	}
	if (strcmp(name, "UPTIME") == 0) {
		handle_uptime_cmd();
		return;
	}
	if (strcmp(name, "STATUS") == 0) {
		handle_status_cmd();
		return;
	}

	if (name[0] == '\0' || action[0] == '\0') {
		/* LED/PWR are multi-token and parsed against the full line — peek */
		if (strcmp(name, "LED") == 0) {
			handle_led_cmd(line);
			return;
		}
		if (strcmp(name, "PWR") == 0) {
			handle_pwr_cmd(line);
			return;
		}
		uart_proto_write("ERR: syntax. Use <NAME> <ON|OFF|TOGGLE|READ>\r\n");
		return;
	}

	/* Multi-token forms (LED/PWR) — parse the whole line. */
	if (strcmp(name, "LED") == 0) {
		handle_led_cmd(line);
		return;
	}
	if (strcmp(name, "PWR") == 0) {
		handle_pwr_cmd(line);
		return;
	}

	/* ADC reads */
	if (strcmp(action, "READ") == 0) {
		(void)adc_read_print(name);
		return;
	}

	/* Brightness */
	if (strcmp(name, "BRIGHT") == 0) {
		handle_bright_cmd(action);
		return;
	}

	/* Fallback: GPIO command */
	handle_gpio_cmd(name, action);
}
```

## src/cmd_dispatch.h
```c
/* SPDX-License-Identifier: Apache-2.0 */
#ifndef APP_CMD_DISPATCH_H_
#define APP_CMD_DISPATCH_H_

void dispatch_line(char *line);

#endif /* APP_CMD_DISPATCH_H_ */
```

## src/gpio_table.c
```c
/* SPDX-License-Identifier: Apache-2.0 */
#include "gpio_table.h"

#include <string.h>
#include <zephyr/kernel.h>
#include <zephyr/devicetree.h>

#define GET(node) GPIO_DT_SPEC_GET(DT_NODELABEL(node), gpios)

static const struct gpio_entry entries[] = {
	{ "P0", GET(p0) },
	{ "P1", GET(p1) },
	{ "P2", GET(p2) },
	{ "P3", GET(p3) },
	{ "P4", GET(p4) },
	{ "P5", GET(p5) },
	{ "P6", GET(p6) },
	{ "P7", GET(p7) },

	{ "LED0G", GET(led0g) },
	{ "LED1G", GET(led1g) },
	{ "LED2G", GET(led2g) },
	{ "LED3G", GET(led3g) },
	{ "LED4G", GET(led4g) },
	{ "LED5G", GET(led5g) },
	{ "LED6G", GET(led6g) },
	{ "LED7G", GET(led7g) },

	{ "LED0R", GET(led0r) },
	{ "LED1R", GET(led1r) },
	{ "LED2R", GET(led2r) },
	{ "LED3R", GET(led3r) },
	{ "LED4R", GET(led4r) },
	{ "LED5R", GET(led5r) },
	{ "LED6R", GET(led6r) },
	{ "LED7R", GET(led7r) },

	{ "PWRLEDG", GET(pwrledg) },
	{ "PWRLEDY", GET(pwrledy) },
};

#define ENTRY_COUNT (sizeof(entries) / sizeof(entries[0]))

/* Indices into entries[] (kept stable so other modules can fetch by slot). */
#define IDX_LED_G_BASE  8
#define IDX_LED_R_BASE  16
#define IDX_PWR_G       24
#define IDX_PWR_Y       25

int gpio_table_init(void)
{
	for (size_t i = 0; i < ENTRY_COUNT; i++) {
		const struct gpio_dt_spec *s = &entries[i].spec;
		if (!gpio_is_ready_dt(s)) {
			continue;   /* skip missing ports; don't kill main */
		}
		/* P0..P7 (indices 0..7) boot HIGH per spec. LEDs and PWR
		 * LEDs boot OFF (logically inactive, respects active-low). */
		gpio_flags_t init_flag = (i < 8) ? GPIO_OUTPUT_HIGH
						 : GPIO_OUTPUT_INACTIVE;
		(void)gpio_pin_configure_dt(s, init_flag);
	}
	return 0;
}

const struct gpio_entry *gpio_table_lookup(const char *name)
{
	for (size_t i = 0; i < ENTRY_COUNT; i++) {
		if (strcmp(name, entries[i].name) == 0) {
			return &entries[i];
		}
	}
	return NULL;
}

int gpio_table_set(const struct gpio_entry *e, bool on)
{
	return gpio_pin_set_dt(&e->spec, on ? 1 : 0);
}

int gpio_table_toggle(const struct gpio_entry *e)
{
	return gpio_pin_toggle_dt(&e->spec);
}

const struct gpio_entry *gpio_table_led_green(uint8_t idx)
{
	if (idx >= LED_COUNT) {
		return NULL;
	}
	return &entries[IDX_LED_G_BASE + idx];
}

const struct gpio_entry *gpio_table_led_red(uint8_t idx)
{
	if (idx >= LED_COUNT) {
		return NULL;
	}
	return &entries[IDX_LED_R_BASE + idx];
}

const struct gpio_entry *gpio_table_pwr_green(void) { return &entries[IDX_PWR_G]; }
const struct gpio_entry *gpio_table_pwr_yellow(void) { return &entries[IDX_PWR_Y]; }
```

## src/gpio_table.h
```c
/* SPDX-License-Identifier: Apache-2.0 */
#ifndef APP_GPIO_TABLE_H_
#define APP_GPIO_TABLE_H_

#include <stdint.h>
#include <stdbool.h>
#include <zephyr/drivers/gpio.h>
#include "proto.h"

struct gpio_entry {
	const char *name;
	struct gpio_dt_spec spec;
};

/* Initialize all output GPIOs as logically OFF (respects active-low). */
int gpio_table_init(void);

/* Look up by canonical name (e.g. "P0", "LED3G", "PWRLEDG"). NULL if absent. */
const struct gpio_entry *gpio_table_lookup(const char *name);

/* Drive logical on/off. Returns 0 on success. */
int gpio_table_set(const struct gpio_entry *e, bool on);
int gpio_table_toggle(const struct gpio_entry *e);

/* Indexed access to line LEDs (idx 0..7). */
const struct gpio_entry *gpio_table_led_green(uint8_t idx);
const struct gpio_entry *gpio_table_led_red(uint8_t idx);
const struct gpio_entry *gpio_table_pwr_green(void);
const struct gpio_entry *gpio_table_pwr_yellow(void);

#endif /* APP_GPIO_TABLE_H_ */
```

## src/led_pwm.c
```c
/* SPDX-License-Identifier: Apache-2.0 */
#include "led_pwm.h"
#include "gpio_table.h"
#include "proto.h"

#include <zephyr/kernel.h>

/*
 * Soft PWM + blink composer.
 *
 * Cadence: 1 kHz (1 ms period). The original CubeIDE firmware drove
 * TIM14 at 10 kHz, but in Zephyr a 10 kHz SysTick rate produced enough
 * timeout-queue churn to starve the USART1 RX IRQ at 115200 baud and
 * lose per-command bytes. 1 kHz tick gives 10× more headroom for the
 * UART ISR and the resulting PWM (10 levels × 100 Hz) is still
 * flicker-free.
 * - Brightness: 10 levels (~10 % resolution).
 * - Blink patterns derive from blink_tick (free-running, ms units):
 *     SLOW: 500 ms on / 500 ms off
 *     FAST: 250 ms on / 250 ms off
 * - SYNC zeroes blink_tick so multiple boards can phase-align.
 *
 * Threading: the composer runs in a dedicated thread woken by k_timer.
 * The timer callback (SysTick ISR context) only k_sem_give's the
 * semaphore, keeping SysTick latency tiny.
 *
 * Bug fix vs legacy CubeIDE firmware: legacy declared blink_tick/blink_phase
 * but never advanced or consulted them, so patterns L/F were no-ops.
 * Patterns now blink end-to-end.
 */

/* PWM cadence: composer thread is woken every 1 ms (K_TICKS(1) at 1 kHz
 * tick rate). With 10 brightness steps we get 100 Hz PWM (flicker-free)
 * and 10 % brightness resolution — original firmware used 100 steps but
 * at the cost of starving UART RX on Zephyr, see prj.conf for rationale. */
#define PWM_PERIOD          10
#define BLINK_SLOW_PERIOD   1000     /* 1 s cycle, 500 ms on/off */
#define BLINK_SLOW_ON       500
#define BLINK_FAST_PERIOD   500      /* 500 ms cycle, 250 ms on/off */
#define BLINK_FAST_ON       250

#define COMPOSER_STACK_SIZE 512
#define COMPOSER_PRIO       2   /* preemptible, above default (-2..0 coop) */

struct led_state {
	uint8_t color;
	uint8_t pattern;
};

static struct led_state line_leds[LED_COUNT];
static struct led_state pwr_led;
static uint8_t brightness_pct = 100;

static struct k_spinlock state_lock;

/* These are mutated only in the composer thread. */
static uint32_t blink_tick;
static uint16_t pwm_counter;

static uint32_t last_bright_set_ms;

static uint8_t last_applied_line[LED_COUNT] = {
	0xFF, 0xFF, 0xFF, 0xFF, 0xFF, 0xFF, 0xFF, 0xFF
};
static uint8_t last_applied_pwr = 0xFF;

static K_SEM_DEFINE(pwm_tick_sem, 0, 1);

static void pwm_timer_handler(struct k_timer *t)
{
	ARG_UNUSED(t);
	k_sem_give(&pwm_tick_sem);
}

static K_TIMER_DEFINE(pwm_timer, pwm_timer_handler, NULL);

static inline bool blink_on_now(uint8_t pattern, uint32_t tick)
{
	switch (pattern) {
	case BLINK_SLOW:
		return (tick % BLINK_SLOW_PERIOD) < BLINK_SLOW_ON;
	case BLINK_FAST:
		return (tick % BLINK_FAST_PERIOD) < BLINK_FAST_ON;
	case BLINK_STEADY:
	default:
		return true;
	}
}

static uint8_t compose_line(const struct led_state *s, uint32_t tick,
			    bool pwm_on)
{
	if (!pwm_on || !blink_on_now(s->pattern, tick)) {
		return 0;
	}
	uint8_t g_on = (s->color == LED_COLOR_GREEN ||
			s->color == LED_COLOR_YELLOW) ? 1 : 0;
	uint8_t r_on = (s->color == LED_COLOR_RED ||
			s->color == LED_COLOR_YELLOW) ? 1 : 0;
	return (uint8_t)((g_on << 1) | r_on);
}

static uint8_t compose_pwr(const struct led_state *s, uint32_t tick,
			   bool pwm_on)
{
	if (!pwm_on || !blink_on_now(s->pattern, tick)) {
		return 0;
	}
	uint8_t g_on = (s->color == PWR_COLOR_GREEN ||
			s->color == PWR_COLOR_LIME) ? 1 : 0;
	uint8_t y_on = (s->color == PWR_COLOR_YELLOW ||
			s->color == PWR_COLOR_LIME) ? 1 : 0;
	return (uint8_t)((g_on << 1) | y_on);
}

static void apply_line_led(uint8_t idx, uint8_t composed)
{
	gpio_table_set(gpio_table_led_green(idx), (composed >> 1) & 1);
	gpio_table_set(gpio_table_led_red(idx), composed & 1);
}

static void apply_pwr_led(uint8_t composed)
{
	gpio_table_set(gpio_table_pwr_green(), (composed >> 1) & 1);
	gpio_table_set(gpio_table_pwr_yellow(), composed & 1);
}

static void composer_thread(void *a, void *b, void *c)
{
	ARG_UNUSED(a); ARG_UNUSED(b); ARG_UNUSED(c);

	struct led_state local_line[LED_COUNT];
	struct led_state local_pwr;
	uint8_t br;

	while (true) {
		k_sem_take(&pwm_tick_sem, K_FOREVER);

		/* Brief snapshot under spinlock (IRQs disabled for ~3 µs). */
		k_spinlock_key_t key = k_spin_lock(&state_lock);
		for (uint8_t i = 0; i < LED_COUNT; i++) {
			local_line[i] = line_leds[i];
		}
		local_pwr = pwr_led;
		br = brightness_pct;
		k_spin_unlock(&state_lock, key);

		blink_tick++;

		bool pwm_on;
		if (br >= 100) {
			pwm_on = true;
		} else {
			pwm_counter++;
			if (pwm_counter >= PWM_PERIOD) {
				pwm_counter = 0;
			}
			/* Scale brightness 0..100 to 0..PWM_PERIOD threshold.
			 * Without this br is compared directly to pwm_counter
			 * (0..PWM_PERIOD-1) and any br >= PWM_PERIOD reads as
			 * always-on — so the entire 10..100 range was identical
			 * to full brightness. */
			uint8_t threshold = (uint8_t)(((uint16_t)br * PWM_PERIOD + 50) / 100);
			pwm_on = (pwm_counter < threshold);
		}

		for (uint8_t i = 0; i < LED_COUNT; i++) {
			uint8_t composed = compose_line(&local_line[i],
							 blink_tick, pwm_on);
			if (composed != last_applied_line[i]) {
				apply_line_led(i, composed);
				last_applied_line[i] = composed;
			}
		}

		uint8_t composed_pwr = compose_pwr(&local_pwr, blink_tick,
						     pwm_on);
		if (composed_pwr != last_applied_pwr) {
			apply_pwr_led(composed_pwr);
			last_applied_pwr = composed_pwr;
		}
	}
}

K_THREAD_DEFINE(pwm_thread_id, COMPOSER_STACK_SIZE,
		composer_thread, NULL, NULL, NULL,
		COMPOSER_PRIO, 0, 0);

int led_pwm_init(void)
{
	k_spinlock_key_t key = k_spin_lock(&state_lock);
	for (uint8_t i = 0; i < LED_COUNT; i++) {
		line_leds[i].color = LED_COLOR_OFF;
		line_leds[i].pattern = BLINK_STEADY;
	}
	pwr_led.color = PWR_COLOR_OFF;
	pwr_led.pattern = BLINK_STEADY;
	brightness_pct = 100;
	k_spin_unlock(&state_lock, key);
	return 0;
}

void led_pwm_start(void)
{
	/* 1 ms cadence (1 kHz SysTick). Keeps UART RX latency safe — the
	 * earlier 10 kHz timer in SysTick context was starving USART1 IRQ
	 * and causing per-command byte loss. */
	k_timer_start(&pwm_timer, K_TICKS(1), K_TICKS(1));
}

void led_pwm_set_led(uint8_t idx, uint8_t color, uint8_t pattern)
{
	if (idx >= LED_COUNT) {
		return;
	}
	k_spinlock_key_t key = k_spin_lock(&state_lock);
	line_leds[idx].color = color;
	line_leds[idx].pattern = pattern;
	k_spin_unlock(&state_lock, key);
}

void led_pwm_set_pwr(uint8_t color, uint8_t pattern)
{
	k_spinlock_key_t key = k_spin_lock(&state_lock);
	pwr_led.color = color;
	pwr_led.pattern = pattern;
	k_spin_unlock(&state_lock, key);
}

void led_pwm_set_brightness(uint8_t pct)
{
	if (pct > 100) {
		pct = 100;
	}
	uint32_t now = k_uptime_get_32();
	if ((now - last_bright_set_ms) < BRIGHT_DEBOUNCE_MS) {
		return;
	}
	last_bright_set_ms = now;

	k_spinlock_key_t key = k_spin_lock(&state_lock);
	brightness_pct = pct;
	k_spin_unlock(&state_lock, key);
}

void led_pwm_get_led(uint8_t idx, uint8_t *color, uint8_t *pattern)
{
	if (idx >= LED_COUNT) {
		if (color) *color = 0;
		if (pattern) *pattern = 0;
		return;
	}
	k_spinlock_key_t key = k_spin_lock(&state_lock);
	if (color) *color = line_leds[idx].color;
	if (pattern) *pattern = line_leds[idx].pattern;
	k_spin_unlock(&state_lock, key);
}

void led_pwm_get_pwr(uint8_t *color, uint8_t *pattern)
{
	k_spinlock_key_t key = k_spin_lock(&state_lock);
	if (color) *color = pwr_led.color;
	if (pattern) *pattern = pwr_led.pattern;
	k_spin_unlock(&state_lock, key);
}

uint8_t led_pwm_get_brightness(void)
{
	k_spinlock_key_t key = k_spin_lock(&state_lock);
	uint8_t v = brightness_pct;
	k_spin_unlock(&state_lock, key);
	return v;
}

void led_pwm_sync(void)
{
	unsigned int key = irq_lock();
	blink_tick = 0;
	pwm_counter = 0;
	irq_unlock(key);
}
```

## src/led_pwm.h
```c
/* SPDX-License-Identifier: Apache-2.0 */
#ifndef APP_LED_PWM_H_
#define APP_LED_PWM_H_

#include <stdint.h>

int led_pwm_init(void);
void led_pwm_start(void);

void led_pwm_set_led(uint8_t idx, uint8_t color, uint8_t pattern);
void led_pwm_set_pwr(uint8_t color, uint8_t pattern);
void led_pwm_set_brightness(uint8_t pct);
void led_pwm_sync(void);

void led_pwm_get_led(uint8_t idx, uint8_t *color, uint8_t *pattern);
void led_pwm_get_pwr(uint8_t *color, uint8_t *pattern);
uint8_t led_pwm_get_brightness(void);


#endif /* APP_LED_PWM_H_ */
```

## src/proto.h
```c
/* SPDX-License-Identifier: Apache-2.0 */
#ifndef APP_PROTO_H_
#define APP_PROTO_H_

/* Both come from app/CMakeLists.txt; the fallbacks are for builds that do not set them
 * (the native_sim tests). The Hub parses this string: plan/system/southbridge_update.md §3.1.
 */
#ifndef SB_FW_VERSION_STR
#define SB_FW_VERSION_STR     "0.0.0"
#endif
#ifndef SB_GIT_SHA_STR
#define SB_GIT_SHA_STR        "00000000"
#endif

#define FIRMWARE_VERSION      "south-zephyr " SB_FW_VERSION_STR " g" SB_GIT_SHA_STR

#define RX_LINE_BUFFER_SIZE   32
#define UART_RX_RING_SIZE     512
#define BRIGHT_DEBOUNCE_MS    50

#define LED_COUNT             8

/* LED color encoding (matches legacy firmware) */
#define LED_COLOR_OFF     0
#define LED_COLOR_GREEN   1
#define LED_COLOR_RED     2
#define LED_COLOR_YELLOW  3   /* green + red simultaneously */

/* PWR LED color encoding */
#define PWR_COLOR_OFF     0
#define PWR_COLOR_GREEN   1
#define PWR_COLOR_YELLOW  2
#define PWR_COLOR_LIME    3   /* green + yellow simultaneously */

/* Blink patterns */
#define BLINK_STEADY      0
#define BLINK_SLOW        1   /* 500 ms on / 500 ms off */
#define BLINK_FAST        2   /* 250 ms on / 250 ms off */

#endif /* APP_PROTO_H_ */
```

## src/shell_cmds.c
```c
/* SPDX-License-Identifier: Apache-2.0
 *
 * Diagnostic shell commands exposed via RTT (Segger J-Link).
 * Independent of the USART1 protocol — both can run in parallel.
 */
#ifdef CONFIG_SHELL

#include "proto.h"
#include "gpio_table.h"
#include "led_pwm.h"

#include <stdlib.h>
#include <string.h>
#include <zephyr/kernel.h>
#include <zephyr/shell/shell.h>

static char led_color_char(uint8_t c)
{
	switch (c) {
	case LED_COLOR_GREEN:  return 'G';
	case LED_COLOR_RED:    return 'R';
	case LED_COLOR_YELLOW: return 'Y';
	default:               return 'O';
	}
}

static char pwr_color_char(uint8_t c)
{
	switch (c) {
	case PWR_COLOR_GREEN:  return 'G';
	case PWR_COLOR_YELLOW: return 'Y';
	case PWR_COLOR_LIME:   return 'L';
	default:               return 'O';
	}
}

static char pattern_char(uint8_t p)
{
	switch (p) {
	case BLINK_SLOW: return 'L';
	case BLINK_FAST: return 'F';
	default:         return 'S';
	}
}

static uint8_t parse_led_color(char c)
{
	switch (c) {
	case 'G': case 'g': return LED_COLOR_GREEN;
	case 'R': case 'r': return LED_COLOR_RED;
	case 'Y': case 'y': return LED_COLOR_YELLOW;
	default:            return LED_COLOR_OFF;
	}
}

static uint8_t parse_pwr_color(char c)
{
	switch (c) {
	case 'G': case 'g': return PWR_COLOR_GREEN;
	case 'Y': case 'y': return PWR_COLOR_YELLOW;
	case 'L': case 'l': return PWR_COLOR_LIME;
	default:            return PWR_COLOR_OFF;
	}
}

static uint8_t parse_pattern(char c)
{
	switch (c) {
	case 'L': case 'l': return BLINK_SLOW;
	case 'F': case 'f': return BLINK_FAST;
	default:            return BLINK_STEADY;
	}
}

static int cmd_status(const struct shell *sh, size_t argc, char **argv)
{
	ARG_UNUSED(argc); ARG_UNUSED(argv);

	shell_print(sh, "firmware  : %s", FIRMWARE_VERSION);
	shell_print(sh, "uptime_ms : %lld", (long long)k_uptime_get());
	shell_print(sh, "brightness: %u", (unsigned)led_pwm_get_brightness());

	for (uint8_t i = 0; i < LED_COUNT; i++) {
		uint8_t color, pattern;
		led_pwm_get_led(i, &color, &pattern);
		shell_print(sh, "led%u      : %c %c",
			    i, led_color_char(color), pattern_char(pattern));
	}

	uint8_t pcolor, ppattern;
	led_pwm_get_pwr(&pcolor, &ppattern);
	shell_print(sh, "pwr       : %c %c",
		    pwr_color_char(pcolor), pattern_char(ppattern));
	return 0;
}

static int cmd_led(const struct shell *sh, size_t argc, char **argv)
{
	if (argc != 4) {
		shell_print(sh, "usage: led <0-7> <O|G|R|Y> <S|L|F>");
		return -EINVAL;
	}
	int idx = atoi(argv[1]);
	if (idx < 0 || idx >= LED_COUNT) {
		shell_print(sh, "idx out of range");
		return -EINVAL;
	}
	led_pwm_set_led((uint8_t)idx, parse_led_color(argv[2][0]),
			parse_pattern(argv[3][0]));
	return 0;
}

static int cmd_pwr(const struct shell *sh, size_t argc, char **argv)
{
	if (argc != 3) {
		shell_print(sh, "usage: pwr <O|G|Y|L> <S|L|F>");
		return -EINVAL;
	}
	led_pwm_set_pwr(parse_pwr_color(argv[1][0]),
			parse_pattern(argv[2][0]));
	return 0;
}

static int cmd_bright(const struct shell *sh, size_t argc, char **argv)
{
	if (argc != 2) {
		shell_print(sh, "usage: bright <0-100>");
		return -EINVAL;
	}
	int v = atoi(argv[1]);
	if (v < 0) v = 0;
	if (v > 100) v = 100;
	led_pwm_set_brightness((uint8_t)v);
	return 0;
}

static int cmd_gpio(const struct shell *sh, size_t argc, char **argv)
{
	if (argc != 3) {
		shell_print(sh, "usage: gpio <NAME> <on|off|toggle>");
		return -EINVAL;
	}
	const struct gpio_entry *e = gpio_table_lookup(argv[1]);
	if (!e) {
		shell_print(sh, "unknown gpio: %s", argv[1]);
		return -EINVAL;
	}
	if (strcmp(argv[2], "on") == 0 || strcmp(argv[2], "ON") == 0) {
		gpio_table_set(e, true);
	} else if (strcmp(argv[2], "off") == 0 || strcmp(argv[2], "OFF") == 0) {
		gpio_table_set(e, false);
	} else if (strcmp(argv[2], "toggle") == 0 || strcmp(argv[2], "TOGGLE") == 0) {
		gpio_table_toggle(e);
	} else {
		shell_print(sh, "unknown action: %s", argv[2]);
		return -EINVAL;
	}
	return 0;
}

extern volatile uint32_t dbg_isr_bytes;
extern volatile uint32_t dbg_isr_drops;
extern volatile uint32_t dbg_dispatch_calls;
extern volatile uint32_t dbg_tx_calls;
extern volatile uint32_t dbg_tx_bytes;

static int cmd_dbg(const struct shell *sh, size_t argc, char **argv)
{
	ARG_UNUSED(argc); ARG_UNUSED(argv);
	shell_print(sh, "isr_bytes      : %u", (unsigned)dbg_isr_bytes);
	shell_print(sh, "isr_drops      : %u", (unsigned)dbg_isr_drops);
	shell_print(sh, "dispatch_calls : %u", (unsigned)dbg_dispatch_calls);
	shell_print(sh, "tx_calls       : %u", (unsigned)dbg_tx_calls);
	shell_print(sh, "tx_bytes       : %u", (unsigned)dbg_tx_bytes);
	return 0;
}

SHELL_CMD_ARG_REGISTER(dbg,    NULL, "uart rx/tx diagnostic counters", cmd_dbg, 1, 0);
SHELL_CMD_ARG_REGISTER(status, NULL, "show state",         cmd_status, 1, 0);
SHELL_CMD_ARG_REGISTER(led,    NULL, "led <i> <O|G|R|Y> <S|L|F>", cmd_led, 4, 0);
SHELL_CMD_ARG_REGISTER(pwr,    NULL, "pwr <O|G|Y|L> <S|L|F>",     cmd_pwr, 3, 0);
SHELL_CMD_ARG_REGISTER(bright, NULL, "bright <0-100>",            cmd_bright, 2, 0);
SHELL_CMD_ARG_REGISTER(gpio,   NULL, "gpio <NAME> <on|off|toggle>", cmd_gpio, 3, 0);

#endif /* CONFIG_SHELL */
```

## src/uart_proto.c
```c
/* SPDX-License-Identifier: Apache-2.0 */
#include "uart_proto.h"
#include "proto.h"
#include "cmd_dispatch.h"

#include <string.h>
#include <zephyr/kernel.h>
#include <zephyr/devicetree.h>
#include <zephyr/drivers/uart.h>
#include <zephyr/sys/ring_buffer.h>

#define UART_NODE DT_ALIAS(host_uart)

static const struct device *const uart_dev = DEVICE_DT_GET(UART_NODE);

RING_BUF_DECLARE(rx_rb, UART_RX_RING_SIZE);

static char line_buf[RX_LINE_BUFFER_SIZE];
static size_t line_len;

/* Diagnostic counters */
volatile uint32_t dbg_isr_bytes;       /* incremented in UART RX ISR */
volatile uint32_t dbg_isr_drops;       /* bytes dropped due to ring-buf full */
volatile uint32_t dbg_dispatch_calls;  /* incremented after dispatch_line */
volatile uint32_t dbg_tx_calls;        /* incremented in uart_proto_write */
volatile uint32_t dbg_tx_bytes;        /* total bytes pushed to uart_poll_out */

static void uart_isr(const struct device *dev, void *user_data)
{
	ARG_UNUSED(user_data);

	if (!uart_irq_update(dev)) {
		return;
	}

	/* Clear any latched error flags (ORE/FE/NE/PE). With CR3.EIE set,
	 * an unhandled ORE leaves the RX path stuck: RDR no longer accepts
	 * new bytes and the IRQ keeps reasserting. uart_err_check clears
	 * the flags via ICR. */
	(void)uart_err_check(dev);

	while (uart_irq_rx_ready(dev)) {
		uint8_t byte;
		int n = uart_fifo_read(dev, &byte, 1);
		if (n != 1) {
			break;
		}
		if (ring_buf_put(&rx_rb, &byte, 1) == 1) {
			dbg_isr_bytes++;
		} else {
			dbg_isr_drops++;
		}
	}
}

int uart_proto_init(void)
{
	if (!device_is_ready(uart_dev)) {
		return -ENODEV;
	}
	uart_irq_rx_disable(uart_dev);
	uart_irq_tx_disable(uart_dev);

	int rc = uart_irq_callback_user_data_set(uart_dev, uart_isr, NULL);
	if (rc < 0) {
		return rc;
	}
	uart_irq_rx_enable(uart_dev);
	/* Match the legacy CubeIDE/HAL config: enable USART error
	 * interrupts (sets CR3.EIE). Without this, ORE/FE/NE errors
	 * silently leave the RX path stuck and lose subsequent bytes. */
	uart_irq_err_enable(uart_dev);
	return 0;
}

void uart_proto_write_bytes(const char *buf, size_t len)
{
	dbg_tx_calls++;
	for (size_t i = 0; i < len; i++) {
		uart_poll_out(uart_dev, (uint8_t)buf[i]);
		dbg_tx_bytes++;
	}
}

void uart_proto_write(const char *s)
{
	uart_proto_write_bytes(s, strlen(s));
}

void uart_proto_poll(void)
{
	uint8_t byte;
	while (ring_buf_get(&rx_rb, &byte, 1) == 1) {
		/* Accept CR, LF, or CRLF as line terminator. Empty lines
		 * (e.g. the LF following a CR in a CRLF pair) are silently
		 * ignored. The original CubeIDE firmware terminated on LF
		 * only, but the production CM4 host (fiber_app) sends CR
		 * alone. */
		if (byte == '\r' || byte == '\n') {
			if (line_len > 0) {
				line_buf[line_len] = '\0';
				dispatch_line(line_buf);
				dbg_dispatch_calls++;
				line_len = 0;
			}
			continue;
		}
		if (line_len < (RX_LINE_BUFFER_SIZE - 1)) {
			line_buf[line_len++] = (char)byte;
		} else {
			line_len = 0;
			uart_proto_write("ERR: line too long\r\n");
			/* swallow remainder of this overflowing line */
			while (ring_buf_get(&rx_rb, &byte, 1) == 1) {
				if (byte == '\r' || byte == '\n') {
					break;
				}
			}
		}
	}
}
```

## src/uart_proto.h
```c
/* SPDX-License-Identifier: Apache-2.0 */
#ifndef APP_UART_PROTO_H_
#define APP_UART_PROTO_H_

#include <stddef.h>

/* Bring up UART RX interrupt + ring buffer. Returns 0 on success. */
int uart_proto_init(void);

/* Drain the ring buffer, assemble lines (terminator '\n', '\r' ignored),
 * and invoke dispatch_line() for each complete line. Non-blocking.
 * Lines longer than RX_LINE_BUFFER_SIZE-1 chars are dropped with an
 * "ERR: line too long\r\n" reply.
 */
void uart_proto_poll(void);

/* Synchronous TX of a NUL-terminated string. */
void uart_proto_write(const char *s);

/* Synchronous TX of len bytes. */
void uart_proto_write_bytes(const char *buf, size_t len);

#endif /* APP_UART_PROTO_H_ */
```
