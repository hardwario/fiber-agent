## hub/firmware/fiber-northbridge/boards/st/stm32wl5moc/Kconfig.stm32wl5moc
```kconfig
# Copyright (c) 2026
# SPDX-License-Identifier: Apache-2.0

config BOARD_STM32WL5MOC
	select SOC_STM32WL55XX
```

## hub/firmware/fiber-northbridge/boards/st/stm32wl5moc/board.yml
```yaml
board:
  name: stm32wl5moc
  full_name: STM32WL5MOC Module
  vendor: st
  socs:
    - name: stm32wl55xx
```

## hub/firmware/fiber-northbridge/tests/cmd_dispatch/testcase.yaml
```yaml
tests:
  firmware.northbridge.cmd_dispatch:
    platform_allow:
      - native_sim
      - native_sim/native/64
    integration_platforms:
      - native_sim
    tags:
      - northbridge
  firmware.northbridge.cmd_dispatch.rx_inject:
    extra_configs:
      - CONFIG_NB_TWR_RX_INJECT=y
    platform_allow:
      - native_sim
      - native_sim/native/64
    integration_platforms:
      - native_sim
    tags:
      - northbridge
```

## hub/firmware/fiber-northbridge/tests/hdlc_framing/testcase.yaml
```yaml
tests:
  firmware.northbridge.hdlc_framing:
    platform_allow:
      - native_sim
    integration_platforms:
      - native_sim
    tags:
      - northbridge
```

## hub/firmware/fiber-northbridge/tests/radio_tune/testcase.yaml
```yaml
tests:
  firmware.northbridge.radio_tune:
    platform_allow:
      - native_sim
    integration_platforms:
      - native_sim
    tags:
      - northbridge
```

## hub/firmware/fiber-southbridge/boards/st/fiber_southbridge/Kconfig.fiber_southbridge
```kconfig
# SPDX-License-Identifier: Apache-2.0

config BOARD_FIBER_SOUTHBRIDGE
	select SOC_STM32C031XX
```

## hub/firmware/fiber-southbridge/boards/st/fiber_southbridge/board.yml
```yaml
board:
  name: fiber_southbridge
  full_name: Fiber Southbridge (STM32C031C6)
  vendor: st
  socs:
    - name: stm32c031xx
```

## hub/firmware/fiber-southbridge/tests/cmd_dispatch/testcase.yaml
```yaml
tests:
  firmware.southbridge.cmd_dispatch:
    platform_allow:
      - native_sim
    integration_platforms:
      - native_sim
    tags:
      - southbridge
```

## hub/firmware/fiber-southbridge/tests/uart_framing/testcase.yaml
```yaml
tests:
  firmware.southbridge.uart_framing:
    platform_allow:
      - native_sim
    integration_platforms:
      - native_sim
    tags:
      - southbridge
```

## hub/system/meta-proximos/conf/layer.conf
```bitbake
BBPATH =. "${LAYERDIR}:"

BBFILES += "${LAYERDIR}/recipes-*/*/*.bb \
            ${LAYERDIR}/recipes-*/*/*.bbappend"

BBFILE_COLLECTIONS += "proximos"
BBFILE_PATTERN_proximos = "^${LAYERDIR}/"
BBFILE_PRIORITY_proximos = "12"

LAYERSERIES_COMPAT_proximos = "wrynose"

LAYERDEPENDS_proximos = "core rauc raspberrypi meta-qbee networking-layer openembedded-layer meta-python rust-bin-layer"

PROXIMOS_LAYERDIR := "${LAYERDIR}"

PROXIMOS_SRC := "${PROXIMOS_LAYERDIR}/../.."
```
