## CMakeLists.txt
```
cmake_minimum_required(VERSION 3.20.0)
list(APPEND BOARD_ROOT ${CMAKE_CURRENT_LIST_DIR}/..)

# Bench-only: bridges the P2P HDLC protocol over the RTT *shell* channel (0),
# carrying frames as `p2p_inject <hex>` in / `P2P_OUT <hex>` out text lines
# instead of over USART1, for rigs with no CM4/USB-serial wired to the real
# UART (J-Link RTT only). Never for production - USART1 is the real link there.
# Build with `west build -b stm32wl5moc app -- -DBENCH_RTT_BRIDGE=ON`.
option(BENCH_RTT_BRIDGE "Bridge the P2P protocol over the RTT shell channel instead of USART1 (bench only)" OFF)
if(BENCH_RTT_BRIDGE)
  # A full-frame p2p_inject must land in ONE RTT write, or the JoinAccept
  # TX_SCHEDULE misses the node's ~1 s RX1 window; the default 16 B channel-0
  # down-buffer chunks it too slowly. Pulled in here so -DBENCH_RTT_BRIDGE=ON
  # alone is sufficient - nothing extra to remember on the build line.
  list(APPEND EXTRA_CONF_FILE ${CMAKE_CURRENT_LIST_DIR}/bench_rtt_bridge.conf)
endif()

# The image is the TOWER gateway (proximos-v2 plan/control/radio/p2p_tower_gateway.md): the
# Northbridge ACKs locally and holds the peer table and the downlink queue the host feeds it
# over USART1. There is no other link protocol to choose; the proto-1 modem image is the
# rollback.
#
# Bench-only TOWER-over-LoRa P0 gateway: the Northbridge runs the TOWER radio protocol itself
# (auto-ACK, one queued downlink) driven from the RTT shell (`twr ...`, TWR_* event lines),
# with the static bench key. No host link, no cmd_dispatch. Needs the bench RTT buffers, so it
# is only accepted together with BENCH_RTT_BRIDGE:
# `west build -b stm32wl5moc app -- -DBENCH_RTT_BRIDGE=ON -DTOWER_P0_GATEWAY=ON`.
option(TOWER_P0_GATEWAY "TOWER P0 bench gateway over the RTT shell (bench only)" OFF)
set(TOWER_P0_NODE_ADDR "0x00000413" CACHE STRING
  "TOWER P0 gateway: boot default node address (low 32 bits of the node DevEUI)")
if(TOWER_P0_GATEWAY)
  if(NOT BENCH_RTT_BRIDGE)
    message(FATAL_ERROR "TOWER_P0_GATEWAY is a bench image: add -DBENCH_RTT_BRIDGE=ON")
  endif()
  list(APPEND EXTRA_CONF_FILE ${CMAKE_CURRENT_LIST_DIR}/tower_p0_gateway.conf)
endif()

# What `west flash` programs: nbboot + app + app_valid record, made after the link (below). The
# board's board.cmake hands it to the runners, which read it while find_package() runs.
set(NB_JLINK_HEX ${CMAKE_BINARY_DIR}/zephyr/northbridge_jlink.hex)

find_package(Zephyr REQUIRED HINTS $ENV{ZEPHYR_BASE})
project(p2p_northbridge_app)

# EVT_BOOT / GET_INFO git_sha: the first 4 bytes of the last commit that touched what goes
# into the app image (app/, boards/, patches/, west.yml), taken when CMake configures (a
# pristine build re-reads it). Path-scoped, not HEAD, so a Hub-only commit of the monorepo, or
# one to the NB docs, tests or tools, leaves the image and its crc32 alone
# (northbridge_update.md §3.2). A shallow clone may answer with its boundary commit: the CI
# fetches full history for it (GIT_DEPTH 0). 0 when this is not a git checkout.
execute_process(
  COMMAND git log -1 --format=%H -- app boards patches west.yml
  WORKING_DIRECTORY ${CMAKE_CURRENT_LIST_DIR}/..
  OUTPUT_VARIABLE NB_GIT_SHA
  OUTPUT_STRIP_TRAILING_WHITESPACE
  ERROR_QUIET
  RESULT_VARIABLE nb_git_rc)
if(NOT nb_git_rc EQUAL 0 OR NOT NB_GIT_SHA MATCHES "^[0-9a-f]+$")
  set(NB_GIT_SHA "00000000")
endif()
string(SUBSTRING "${NB_GIT_SHA}00000000" 0 8 NB_GIT_SHA)
target_compile_definitions(app PRIVATE APP_GIT_SHA=0x${NB_GIT_SHA}u)

if(BENCH_RTT_BRIDGE)
  target_compile_definitions(app PRIVATE APP_P2P_BENCH_RTT_BRIDGE=1)
endif()

if(TOWER_P0_GATEWAY)
  target_compile_definitions(app PRIVATE
    APP_TWR_P0_GATEWAY=1
    TWR_NODE_ADDR_DEFAULT=${TOWER_P0_NODE_ADDR}u
  )
  target_sources(app PRIVATE
    src/twr_gw.c
    src/twr_radio.c
  )
else()
  target_sources(app PRIVATE
    src/cmd_dispatch.c
    src/twr_gateway.c
    src/twr_peers.c
    src/twr_dlq.c
    src/twr_gwc.c
    src/twr_ackctrl.c
    src/twr_evq.c
    src/twr_link.c
    src/twr_cmd.c
    # Update through the Hub: ENTER_BOOTLOADER, GET_INFO app_image_len / app_crc32.
    src/nb_boot.c
    ${CMAKE_CURRENT_LIST_DIR}/../nbboot/src/nb_app_valid.c
  )
endif()

target_sources(app PRIVATE
  src/main.c
  src/hdlc.c
  src/uart_link.c
  src/diag.c
  src/twr_crypto.c
  src/twr_frame.c
  src/twr_airtime.c
)

# The patched LoRa driver (patches/README.md) is compiled from this repo, in place of the
# workspace's vendored zephyr/drivers/lora/loramac-node/sx126x.c: nothing to copy into the
# zephyr tree, and a stale copy there no longer matters. drivers/lora/loramac-node adds the
# file relative to its own directory, hence the bare name.
set(NB_PATCH_DIR ${CMAKE_CURRENT_LIST_DIR}/../patches/lora)
if(TARGET loramac-node)
  get_target_property(nb_loramac_sources loramac-node SOURCES)
  set(nb_vendored_sx126x ${nb_loramac_sources})
  list(FILTER nb_vendored_sx126x INCLUDE REGEX "(^|/drivers/lora/loramac-node/)sx126x\\.c$")
  list(LENGTH nb_vendored_sx126x nb_vendored_count)
  if(NOT nb_vendored_count EQUAL 1)
    message(FATAL_ERROR "patches/lora/sx126x.c: expected one vendored sx126x.c in target "
      "loramac-node, found '${nb_vendored_sx126x}' - re-check after a Zephyr bump")
  endif()
  list(REMOVE_ITEM nb_loramac_sources ${nb_vendored_sx126x})
  set_property(TARGET loramac-node PROPERTY SOURCES
    ${nb_loramac_sources} ${NB_PATCH_DIR}/sx126x.c)
  target_include_directories(loramac-node PRIVATE
    ${ZEPHYR_BASE}/drivers/lora/loramac-node ${NB_PATCH_DIR})
  # RxDone / TxDone stamps and the timed SetTx (twr_gateway.c, twr_radio.c in the P0 image).
  target_compile_definitions(loramac-node PRIVATE NB_TWR_HOOKS=1)
endif()

# 0.2.2: RX sensitivity tuning (docs/problems.md 1, Kconfig.radio_tune).
if(CONFIG_NB_RADIO_TUNE)
  target_sources(app PRIVATE src/radio_tune.c src/radio_tune_hw.c)
  target_include_directories(app PRIVATE ${NB_PATCH_DIR})
endif()

# ---- update through the Hub (plan/control/radio/northbridge_update.md §3, §10) -------------
#
# The app lives in slot0 at 0x0800_0800 (board dts, zephyr,code-partition) behind nbboot, which
# starts it only when the app_valid record matches the image. Every build therefore also makes
#   build/nbboot/nbboot.{elf,bin,hex}       the boot stub, with this build's compiler;
#   build/zephyr/northbridge.{bin,json}     the update image and its manifest (nb_package.py);
#   build/zephyr/app_valid.bin              the 32 B record for that image;
#   build/zephyr/northbridge_jlink.hex      nbboot + app + record,
# and `west flash` programs northbridge_jlink.hex, so a J-Link flash leaves a bootable layout
# (zephyr.hex alone would land in the ROM bootloader: no record).
set(NB_DIR ${CMAKE_CURRENT_LIST_DIR}/..)
set(NB_NBBOOT_SRC ${NB_DIR}/nbboot/src)
target_include_directories(app PRIVATE ${NB_NBBOOT_SRC})

include(ExternalProject)
set(NB_NBBOOT_BUILD ${CMAKE_BINARY_DIR}/nbboot)
ExternalProject_Add(nbboot
  SOURCE_DIR ${NB_DIR}/nbboot
  BINARY_DIR ${NB_NBBOOT_BUILD}
  CMAKE_ARGS
    -DCMAKE_C_COMPILER=${CMAKE_C_COMPILER}
    -DCMAKE_OBJCOPY=${CMAKE_OBJCOPY}
  INSTALL_COMMAND ""
  BUILD_ALWAYS ON
  BUILD_BYPRODUCTS ${NB_NBBOOT_BUILD}/nbboot.bin ${NB_NBBOOT_BUILD}/nbboot.hex
)
add_dependencies(app nbboot)

file(STRINGS ${CMAKE_CURRENT_LIST_DIR}/src/proto.h nb_ver_lines
  REGEX "^#define FW_VERSION_(MAJOR|MINOR|PATCH) [0-9]+$")
foreach(part MAJOR MINOR PATCH)
  # if(... MATCHES) resets CMAKE_MATCH_*, so take the group before testing it.
  string(REGEX MATCH "FW_VERSION_${part} ([0-9]+)" _ "${nb_ver_lines}")
  set(NB_FW_${part} "${CMAKE_MATCH_1}")
  if(NB_FW_${part} STREQUAL "")
    message(FATAL_ERROR "FW_VERSION_${part} not found in src/proto.h")
  endif()
endforeach()
set(NB_FW_VERSION "${NB_FW_MAJOR}.${NB_FW_MINOR}.${NB_FW_PATCH}")

set(NB_OUT ${CMAKE_BINARY_DIR}/zephyr)
# The version and sha this build carries, for nb_package.py run on the build dir by hand or by
# the CI (it reads them from here when --fw-version / --git-sha are not given).
file(WRITE ${NB_OUT}/nb_build.json
  "{\"fw_version\": \"${NB_FW_VERSION}\", \"git_sha\": \"${NB_GIT_SHA}\"}\n")
set(NB_PACKAGE_OUTPUTS
  ${NB_OUT}/northbridge.bin ${NB_OUT}/northbridge.json ${NB_OUT}/app_valid.bin ${NB_JLINK_HEX})
# Runs after the final link: zephyr.bin is a byproduct of the ELF target's post-build steps.
add_custom_command(OUTPUT ${NB_PACKAGE_OUTPUTS}
  COMMAND ${PYTHON_EXECUTABLE} ${NB_DIR}/tools/nb_package.py
    --bin ${NB_OUT}/${KERNEL_BIN_NAME}
    --fw-version ${NB_FW_VERSION}
    --git-sha ${NB_GIT_SHA}
    --out-dir ${NB_OUT}
    --record ${NB_OUT}/app_valid.bin
    --nbboot ${NB_NBBOOT_BUILD}/nbboot.bin
    --jlink-hex ${NB_JLINK_HEX}
  DEPENDS ${logical_target_for_zephyr_elf} ${NB_OUT}/${KERNEL_BIN_NAME} nbboot
    ${NB_NBBOOT_BUILD}/nbboot.bin ${NB_DIR}/tools/nb_package.py ${NB_DIR}/tools/nb_app_valid.py
  COMMENT "nb_package: northbridge.bin, northbridge.json, northbridge_jlink.hex"
)
add_custom_target(nb_package ALL DEPENDS ${NB_PACKAGE_OUTPUTS})
```

## Kconfig
```
# SPDX-License-Identifier: Apache-2.0

rsource "Kconfig.radio_tune"
rsource "Kconfig.gateway"

source "Kconfig.zephyr"
```

## Kconfig.gateway
```
# SPDX-License-Identifier: Apache-2.0
#
# TOWER gateway options (#470 Northbridge-Hub link protocol). Sourced by app/Kconfig and by
# the native_sim tests that build the gateway core.

config NB_EVT_RING_SIZE
	int "Event ring entries (EVT_TWR_UPLINK / EVT_TWR_TX awaiting TWR_EVT_ACK)"
	range 32 127
	default 32
	help
	  Events the Northbridge keeps until the host confirms them with TWR_EVT_ACK
	  (link protocol §4.1). The body pool is sized for this many uplinks of the
	  lora MTU (78 B plaintext, ~100 B each). When the events of a received frame
	  do not fit, the frame is dropped whole: no ACK, no last_seen update. Below
	  128 so the u8 delivery seq window cannot alias.

config NB_TWR_RX_INJECT
	bool "Bench shell 'p2p rx_inject <hex> [rssi_dbm]' (never in production)"
	default n
	help
	  Feeds a captured air frame into the gateway's receive path as if the
	  radio had received it (classification, replay rule, ACK on air, events),
	  so e.g. a replayed frame -> rx_replay can be checked on HIL. Only in
	  state GATEWAY. GET_INFO build_flags b2 (RX_INJECT) is set when it is
	  compiled in.
```

## Kconfig.radio_tune
```
# SPDX-License-Identifier: Apache-2.0
#
# Northbridge RX sensitivity tuning, 0.2.2 (docs/problems.md §1). Each option is the
# boot default of one `radio tune` item; the RTT shell switches them at run time.
# The RX items boot on; everything that changes TX boots off, so a modem that resets
# mid-test comes back with the stock TX path (turn TX items on over RTT).
# Sourced by app/Kconfig and tests/radio_tune/Kconfig.

menuconfig NB_RADIO_TUNE
	bool "Northbridge radio tuning (docs/problems.md 1)"
	default y
	help
	  Board-level tuning hooks for the patched sx126x driver
	  (patches/lora/nb_sx126x_hooks.h), a boot log line of the effective
	  tuning and the `radio tune` RTT shell. With n the driver runs its
	  stock init: power-saving RX gain, chip-default SMPS drive, DC-DC,
	  the devicetree's PA row and a 40 us ramp.

if NB_RADIO_TUNE

config NB_RADIO_TUNE_RX_BOOST
	bool "RX boosted gain (0x08AC)"
	default y
	help
	  Substitute the boosted LNA gain for the 0x94 (power saving) that
	  loramac-node's SX126xSetRx() writes to 0x08AC before every SET_RX.
	  RX only.

config NB_RADIO_TUNE_RX_BOOST_VALUE
	hex "RX boosted gain value"
	default 0x96
	range 0x96 0x97
	help
	  0x96 is the boosted gain of the SX1261/2 datasheet and of Zephyr's
	  native sx126x driver; 0x97 is what the 0.1.x/0.2.x wake-up patch
	  wrote (never effective, see docs/problems.md 1). Used while
	  rx_boost is on.

config NB_RADIO_TUNE_SMPS_RX
	bool "SMPS drive level in RX (0x0923)"
	default y
	help
	  Set the SMPS drive level (SUBGHZ_SMPSC2R bits 2:1) before every
	  SET_RX. RX only.

config NB_RADIO_TUNE_SMPS_RX_MA
	int "SMPS drive level in RX, mA (20, 40, 60 or 100)"
	default 40
	help
	  Used while smps_rx is on, also after `radio tune set smps_rx on`.

config NB_RADIO_TUNE_DCDC
	bool "Regulator mode DC-DC + LDO"
	default y
	help
	  SetRegulatorMode(0x01). loramac-node's RadioInit() already sends
	  it, so y adds nothing at boot; n sends LDO only (0x00) after the
	  driver's init. Affects RX and TX.

config NB_RADIO_TUNE_SMPS_TX
	bool "SMPS drive level in TX (0x0923) - changes TX"
	help
	  Set the SMPS drive level before every SET_TX. Off, TX gets the
	  chip's own drive level back (read at boot) if smps_rx changed it.

config NB_RADIO_TUNE_SMPS_TX_MA
	int "SMPS drive level in TX, mA (20, 40, 60 or 100)"
	default 60
	help
	  Used while smps_tx is on, e.g. after `radio tune set smps_tx on`.

config NB_RADIO_TUNE_PA_TABLE
	bool "RFO-LP PA config by requested power - changes TX"
	help
	  Pick the SetPaConfig row (+15 dBm 0x07, +14 dBm 0x04, +10 dBm 0x01)
	  by the requested TX power instead of by the devicetree's
	  rfo-lp-max-power. At the host's 14 dBm: 0x04 / power 14 instead of
	  0x07 / power 13.

config NB_RADIO_TUNE_RAMP_200US
	bool "200 us PA ramp instead of 40 us - changes TX"
	help
	  SetTxParams ramp time 200 us (0x04). Starts the preamble ~160 us
	  later than the driver's 40 us; no effect on RX.

endif # NB_RADIO_TUNE
```

## prj.conf
```kconfig
# Drivers
CONFIG_SERIAL=y
CONFIG_UART_INTERRUPT_DRIVEN=y
CONFIG_LORA=y
CONFIG_RING_BUFFER=y
CONFIG_CRC=y
CONFIG_HWINFO=y

# USART1 (ttyAMA3 side) is exclusive to the P2P binary protocol - no
# console/shell on it (see the devicetree chosen{} removal + p2p-uart
# alias in boards/st/stm32wl5moc/stm32wl5moc.dts).
CONFIG_UART_CONSOLE=n

# Debug console + shell over SEGGER RTT (J-Link) instead - zero UART pins
# consumed, matches fiber-southbridge's pattern.
CONFIG_USE_SEGGER_RTT=y
CONFIG_SHELL=y
CONFIG_SHELL_BACKEND_RTT=y
CONFIG_SHELL_PROMPT_RTT="north:~$ "
CONFIG_SHELL_RTT_RX_POLL_PERIOD=50

# Do not also enable CONFIG_LOG_BACKEND_RTT: it and the shell's own log
# backend both default to RTT buffer index 0 and hit a BUILD_ASSERT
# together (system/lora/design.md §1).
CONFIG_LOG=y
CONFIG_LOG_DEFAULT_LEVEL=3

# 1 kHz tick so the scheduled-TX k_timer can hit ms-resolution deadlines -
# the default 100 Hz tick would quantize scheduling to 10 ms, deep into the
# node's RX1 budget (system/lora/design.md §4).
CONFIG_SYS_CLOCK_TICKS_PER_SEC=1000

# Stack: the main thread runs the commands; GET_INFO and TWR_NODE_LIST build their RSP on it.
CONFIG_MAIN_STACK_SIZE=4096

# The sx126x DIO1 IRQ handler runs the deep loramac-node IrqProcess/RxDone chain
# (which calls lora_rx_cb) on the SYSTEM workqueue. The default 1024 B stack
# overflows there on the first received frame (MemManage fault), which silently
# kills RX. 2048 gives the RX call chain headroom.
CONFIG_SYSTEM_WORKQUEUE_STACK_SIZE=2048

# The gateway's clock (twr_gateway.c): every t_ms on the link and the driver hook stamps are
# k_cycle_get_64(); the 32-bit cycle counter wraps every 89 s at 48 MHz. The SysTick driver
# keeps the count in software anyway.
CONFIG_CORTEX_M_SYSTICK_64BIT_CYCLE_COUNTER=y

# 0.2.0: the independent watchdog, 8 s (northbridge_diagnostics.md §2.3).
CONFIG_WATCHDOG=y

# 0.4.0: ENTER_BOOTLOADER reboots into nbboot -> ROM bootloader (northbridge_update.md §10).
CONFIG_REBOOT=y
```

## bench_rtt_bridge.conf
```kconfig
# Bench RTT-bridge build only (-DBENCH_RTT_BRIDGE=ON, pulled in automatically by
# app/CMakeLists.txt). The host drives the P2P protocol by writing
# `p2p_inject <hex>` to the RTT *shell* channel (0); a whole frame must land in
# a single RTT write, or the JoinAccept TX_SCHEDULE reaches the modem after its
# aim time and the node never pairs (tx stays 0, no EVT_TX_DONE). The default
# 16 B channel-0 down-buffer chunks a full hex-encoded frame across many writes
# and is too slow for that - 256 B holds a max-size frame in one write. The
# larger buffer moves _SEGGER_RTT, so re-read its address from the .elf.
CONFIG_SEGGER_RTT_BUFFER_SIZE_DOWN=256

# `p2p_inject <hex>` is a *shell command*, so the whole hex-encoded frame has to fit one shell
# line. Worst case is P2P_MAX_ENCODED_LEN = 570 B -> 1140 hex characters, plus 11 for
# "p2p_inject " = 1151. Zephyr's default 256 silently truncates any line past it, which on this
# bridge looks like a frame the modem never answers rather than like a buffer that is too small.
# 1200 leaves margin and costs ~1 KB of RAM on a part using a third of it.
CONFIG_SHELL_CMD_BUFF_SIZE=1200

# The RX path runs on the SYSTEM workqueue (sx126x DIO1 IRQ -> k_work_submit ->
# lora_rx_cb). Up to 0.2.x uart_link_send() stack-allocated the worst-case escaped
# frame (~570 B) plus its hex line (~1.15 KB) on the caller, so prj.conf's 2048 B
# system workqueue overflowed on the first EVT_RX after a scheduled TX (bench finding
# 2026-09-08: fault just below sys_work_q_stack while lora_rx_cb was encoding). Both
# buffers are static under the link's TX mutex now (uart_link.c); 4096 stays until a
# bench run measures the headroom again.
CONFIG_SYSTEM_WORKQUEUE_STACK_SIZE=4096

# The 2026-09-09 bench fault (BUS FAULT, pc/lr 0x27023144 unmapped, "Current
# thread" 4 B past __data_region_end, fatal reason 27) printed only r0-r3,
# r12, lr, pc and xpsr - no stack pointer, no callee-saved registers - so it
# could not be told apart from a second stack overflow. With this on, the
# fatal handler also dumps r4-r11 and the faulting SP (arch/arm fatal.c,
# ESF extra info). Costs ~11 KB of flash (74.3 -> 85.5 KB text, 32.9 % of the
# part) on the bench build only.
CONFIG_EXTRA_EXCEPTION_INFO=y
```

## tower_p0_gateway.conf
```kconfig
# TOWER P0 bench gateway only (-DTOWER_P0_GATEWAY=ON, pulled in by app/CMakeLists.txt).

# The TWR_* event lines stamp RxDone / TX start / TxDone in microseconds from
# k_cycle_get_64() (CONFIG_CORTEX_M_SYSTICK_64BIT_CYCLE_COUNTER, prj.conf).

# A TWR_RX line with a 255 B frame and its plaintext is ~1.1 KB, and NO_BLOCK_SKIP drops any
# write that does not fit whole: room for a few lines between two J-Link polls of channel 0.
CONFIG_SEGGER_RTT_BUFFER_SIZE_UP=4096
```

## src/main.c
```c
/* SPDX-License-Identifier: Apache-2.0
 *
 * Northbridge TOWER gateway firmware (proximos-v2 plan/control/radio/p2p_tower_gateway.md):
 * brings up the radio and the P2P UART link, announces EVT_BOOT, then pumps uart_link_poll()
 * on this thread - the commands run in cmd_dispatch.c / twr_cmd.c, the radio side in
 * twr_gateway.c.
 *
 * USART1 (ttyAMA3-side) is exclusive to the binary protocol; there is no
 * console/shell on it. Debug output (this file's shell commands, LOG_*)
 * goes out over SEGGER RTT instead - see fiber-northbridge/README.md.
 */
#include "diag.h"
#include "proto.h"
#include "uart_link.h"
#if defined(APP_TWR_P0_GATEWAY)
#include "twr_radio.h"
#else
#include "cmd_dispatch.h"
#include "radio_ctl.h"
#include "twr_gateway.h"
#include "twr_link.h"
#endif

#include <stdlib.h>
#include <string.h>
#include <zephyr/kernel.h>
#include <zephyr/device.h>
#include <zephyr/drivers/gpio.h>
#include <zephyr/drivers/hwinfo.h>
#include <zephyr/drivers/watchdog.h>
#include <zephyr/shell/shell.h>

#define LOG_LEVEL CONFIG_LOG_DEFAULT_LEVEL
#include <zephyr/logging/log.h>
LOG_MODULE_REGISTER(app);

/* The independent watchdog (northbridge_diagnostics.md §2.3, Hynek Q3: 8 s). Fed from the
 * main loop, and only while no transmission has run far past its time on air
 * (radio_ctl_tx_stuck(): twice the ToA plus 2 s): a radio that stops answering mid-TX (the
 * STICKER's F-P2P-3 wedge) then ends in a reset the host sees as reset_cause "watchdog", not
 * a silent modem. Paused while a debugger halts the core, so a J-Link session does not reset
 * it. */
#define WDT_TIMEOUT_MS 8000

static uint8_t read_and_clear_reset_cause(void)
{
	uint32_t cause = 0;

	/* Passed through as Zephyr's native reset-cause bitmask (truncated
	 * to 8 bits), not remapped to a dedicated wire enum - the spec only
	 * says "reset_cause u8" and multiple bits can be latched at once
	 * (e.g. POR + PIN together on first power-up). Flagged for the
	 * host-side implementer to confirm this interpretation.
	 */
	if (hwinfo_get_reset_cause(&cause) == 0) {
		hwinfo_clear_reset_cause();
	}
	return (uint8_t)cause;
}

#if !defined(APP_TWR_P0_GATEWAY)
/* fw_ver, git_sha, reset_cause: the host checks the image before it configures anything
 * (flag day: no protocol version byte, the gateway is the only image). */
static void send_evt_boot(void)
{
	struct twr_identity id;
	uint8_t body[P2P_EVT_BOOT_BODY_LEN];

	cmd_identity(&id);
	uart_link_send_event(P2P_EVT_BOOT, body, twr_link_enc_boot(&id, body));
}
#else
/* uart_link.c is linked for diag.c's EVT_LOG lines but never started: no commands. */
void proto_on_frame(uint8_t type, uint8_t seq, const uint8_t *body, size_t body_len)
{
	ARG_UNUSED(type);
	ARG_UNUSED(seq);
	ARG_UNUSED(body);
	ARG_UNUSED(body_len);
}
#endif /* !APP_TWR_P0_GATEWAY */

static int cmd_rf_diag(const struct shell *sh, size_t argc, char **argv)
{
	ARG_UNUSED(argc);
	ARG_UNUSED(argv);

	const struct device *gpioc = DEVICE_DT_GET(DT_NODELABEL(gpioc));

	if (!device_is_ready(gpioc)) {
		shell_error(sh, "GPIOC not ready");
		return -ENODEV;
	}

	shell_print(sh, "RF switch GPIO state:");
	shell_print(sh, "  PC3 (FE_CTRL1): %d", gpio_pin_get(gpioc, 3));
	shell_print(sh, "  PC4 (FE_CTRL2): %d", gpio_pin_get(gpioc, 4));
	shell_print(sh, "  PC5 (FE_CTRL3): %d", gpio_pin_get(gpioc, 5));

	return 0;
}

SHELL_CMD_REGISTER(rf_diag, NULL, "Show RF switch GPIO states (PC3/PC4/PC5)", cmd_rf_diag);

static int cmd_p2p_status(const struct shell *sh, size_t argc, char **argv)
{
	ARG_UNUSED(argc);
	ARG_UNUSED(argv);

	struct diag_info d;

	diag_snapshot(&d);
	shell_print(sh, "uptime_ms=%llu link_crc_err=%u link_tx_drops=%u",
		    (unsigned long long)k_uptime_get(), uart_link_get_crc_err_count(),
		    uart_link_get_tx_drops());
	shell_print(sh,
		    "diag: radio_state=%u reset_cause=0x%02x err_flags=0x%08x rx_rearm_fail=%u "
		    "tx_radio_err=%u link_err=%u last_err=%u age_s=%u",
		    d.radio_state, d.boot_reset_cause, d.err_flags, d.rx_rearm_fail, d.tx_radio_err,
		    d.link_err, d.last_err_code, d.last_err_age_s);
#if defined(APP_TWR_P0_GATEWAY)
	twr_radio_print_brief(sh);
#else
	struct radio_config cfg;

	if (radio_ctl_get_config(&cfg)) {
		shell_print(sh, "radio: freq=%u sf=%u bw=%u cr=%u preamble=%u tx_power=%d flags=0x%02x",
			    cfg.frequency_hz, cfg.sf, cfg.bw, cfg.cr, cfg.preamble_len,
			    cfg.tx_power_dbm, cfg.flags);
	} else {
		shell_print(sh, "radio: not configured");
	}
	twr_gateway_print_brief(sh);
#endif

	return 0;
}

SHELL_CMD_REGISTER(p2p_status, NULL, "Show P2P link/radio diagnostics", cmd_p2p_status);

/* HIL checks of the 0.2.0 diagnostics over the RTT shell (needs a J-Link, so not reachable
 * from the Hub): `nb_selftest log <code>` reports an error as the firmware would,
 * `nb_selftest wdt` stops feeding the watchdog, which must reset the modem within 8 s. */
static volatile bool selftest_starve_watchdog;

static int cmd_nb_selftest(const struct shell *sh, size_t argc, char **argv)
{
	if (argc == 3 && strcmp(argv[1], "log") == 0) {
		int code = atoi(argv[2]);

		if (code <= DIAG_CODE_NONE || code >= DIAG_CODE_COUNT) {
			shell_error(sh, "code 1..%d", DIAG_CODE_COUNT - 1);
			return -EINVAL;
		}
		diag_report((enum diag_code)code, "selftest");
		shell_print(sh, "reported code %d", code);
		return 0;
	}
	if (argc == 2 && strcmp(argv[1], "wdt") == 0) {
		shell_print(sh, "watchdog no longer fed: reset expected within %d ms", WDT_TIMEOUT_MS);
		selftest_starve_watchdog = true;
		return 0;
	}
	shell_error(sh, "usage: nb_selftest log <code> | nb_selftest wdt");
	return -EINVAL;
}

/* Not in the TOWER P0 gateway: there is no host link there. */
#if defined(APP_P2P_BENCH_RTT_BRIDGE) && !defined(APP_TWR_P0_GATEWAY)

static int hex_nibble(char c)
{
	if (c >= '0' && c <= '9') {
		return c - '0';
	}
	if (c >= 'a' && c <= 'f') {
		return c - 'a' + 10;
	}
	if (c >= 'A' && c <= 'F') {
		return c - 'A' + 10;
	}
	return -1;
}

static int cmd_p2p_inject(const struct shell *sh, size_t argc, char **argv)
{
	if (argc != 2) {
		shell_error(sh, "usage: p2p_inject <hex bytes, no spaces>");
		return -EINVAL;
	}

	const char *hex = argv[1];
	size_t hex_len = strlen(hex);

	if (hex_len == 0 || (hex_len % 2) != 0) {
		shell_error(sh, "hex string must be an even number of digits");
		return -EINVAL;
	}

	uint8_t bytes[512];
	size_t n = hex_len / 2;

	if (n > sizeof(bytes)) {
		shell_error(sh, "too many bytes (max %zu)", sizeof(bytes));
		return -EINVAL;
	}

	for (size_t i = 0; i < n; i++) {
		int hi = hex_nibble(hex[2 * i]);
		int lo = hex_nibble(hex[2 * i + 1]);

		if (hi < 0 || lo < 0) {
			shell_error(sh, "invalid hex digit at position %zu", 2 * i);
			return -EINVAL;
		}
		bytes[i] = (uint8_t)((hi << 4) | lo);
	}

	uart_link_bench_inject(bytes, n);
	shell_print(sh, "OK: injected %zu bytes", n);
	return 0;
}

SHELL_CMD_REGISTER(p2p_inject, NULL,
		    "Bench only: feed hex-encoded raw bytes to the P2P HDLC decoder, "
		    "as if they had just arrived over USART1",
		    cmd_p2p_inject);

#endif /* APP_P2P_BENCH_RTT_BRIDGE && !APP_TWR_P0_GATEWAY */

SHELL_CMD_REGISTER(nb_selftest, NULL, "HIL: report a diag error, or starve the watchdog",
		   cmd_nb_selftest);

static const struct device *const wdt = DEVICE_DT_GET_OR_NULL(DT_NODELABEL(iwdg));
static int wdt_channel = -1;

static void watchdog_start(void)
{
	if (wdt == NULL || !device_is_ready(wdt)) {
		LOG_WRN("no independent watchdog");
		return;
	}
	struct wdt_timeout_cfg cfg = {
		.window = { .min = 0, .max = WDT_TIMEOUT_MS },
		.flags = WDT_FLAG_RESET_SOC,
	};

	wdt_channel = wdt_install_timeout(wdt, &cfg);
	if (wdt_channel < 0 || wdt_setup(wdt, WDT_OPT_PAUSE_HALTED_BY_DBG) != 0) {
		LOG_ERR("watchdog setup failed");
		wdt_channel = -1;
	}
}

#if defined(APP_TWR_P0_GATEWAY)

/* Bench TOWER P0 gateway (twr_radio.c): the radio belongs to the gateway, the host link is not
 * started. The watchdog is kept, gated on twr_radio_tx_stuck() instead of radio_ctl's. */
int main(void)
{
	diag_set_boot_reset_cause(read_and_clear_reset_cause());
	if (twr_radio_init() != 0) {
		LOG_ERR("twr_radio_init failed");
	}
	LOG_INF("TOWER P0 gateway (fw %d.%d.%d-twr-p0, gw 0x%08X, node 0x%08X)", FW_VERSION_MAJOR,
		FW_VERSION_MINOR, FW_VERSION_PATCH, twr_radio_gw_addr(), twr_radio_node_addr());

	watchdog_start();

	while (1) {
		if (wdt_channel >= 0 && !twr_radio_tx_stuck() && !selftest_starve_watchdog) {
			wdt_feed(wdt, wdt_channel);
		}
		k_msleep(1);
	}

	return 0;
}

#else /* !APP_TWR_P0_GATEWAY */

int main(void)
{
	diag_set_boot_reset_cause(read_and_clear_reset_cause());

	/* A radio that fails to come up is reported, not fatal: the link still answers
	 * GET_INFO (radio_state error, err_flags b0) and EVT_LOG code 1, so the host can tell
	 * a broken radio from a dead modem. */
	bool radio_ok = radio_ctl_init() == 0;

	if (!radio_ok) {
		LOG_ERR("radio_ctl_init failed");
	}

	if (uart_link_init() != 0) {
		LOG_ERR("uart_link_init failed");
		return 0;
	}

	send_evt_boot();
	if (!radio_ok) {
		diag_report(DIAG_CODE_RADIO_INIT, "radio init failed");
	}
	LOG_INF("TOWER gateway ready (fw %d.%d.%d, git %08x)", FW_VERSION_MAJOR, FW_VERSION_MINOR,
		FW_VERSION_PATCH, (unsigned int)APP_GIT_SHA);

	watchdog_start();

	while (1) {
		uart_link_poll();
		if (wdt_channel >= 0 && !radio_ctl_tx_stuck() && !selftest_starve_watchdog) {
			wdt_feed(wdt, wdt_channel);
		}
		k_msleep(1);
	}

	return 0;
}

#endif /* APP_TWR_P0_GATEWAY */
```

## src/cmd_dispatch.c
```c
/* SPDX-License-Identifier: Apache-2.0
 *
 * Command dispatch of the gateway image: parses host->Northbridge command frames, validates
 * wire parameters, calls into radio_ctl (twr_gateway.c) or the TOWER gateway commands
 * (twr_cmd.c), and sends back the RSP. An unknown command - the retired RX_START (0x03) and
 * TWR_GET_STATS (0x16) included - answers UNSUPPORTED. TWR_EVT_ACK (0x18) is the one
 * command that is never answered.
 */
#include "cmd_dispatch.h"
#include "diag.h"
#include "nb_boot.h"
#include "proto.h"
#include "radio_ctl.h"
#include "twr_cmd.h"
#include "twr_gwc.h"
#include "twr_link.h"
#include "twr_rt.h"
#include "uart_link.h"

#include <string.h>
#include <zephyr/sys/byteorder.h>

static void send_rsp(uint8_t cmd, uint8_t seq, enum p2p_status status,
		      const uint8_t *payload, size_t payload_len)
{
	/* GET_INFO is the largest RSP here (twr_cmd.c sends its own). */
	uint8_t body[1 + P2P_GET_INFO_LEN];
	size_t n = 0;

	body[n++] = (uint8_t)status;
	if (status == P2P_STATUS_OK && payload_len > 0 && payload_len <= P2P_GET_INFO_LEN) {
		memcpy(&body[n], payload, payload_len);
		n += payload_len;
	}
	uart_link_send(P2P_RSP(cmd), seq, body, n);
}

void cmd_identity(struct twr_identity *id)
{
	struct diag_info d;
	uint32_t sha = APP_GIT_SHA;

	id->fw_ver[0] = FW_VERSION_MAJOR;
	id->fw_ver[1] = FW_VERSION_MINOR;
	id->fw_ver[2] = FW_VERSION_PATCH;
	/* Display order: the first byte is the first two hex digits of the commit. */
	sys_put_be32(sha, id->git_sha);
	diag_snapshot(&d);
	id->reset_cause = d.boot_reset_cause;
	id->build_flags = 0;
#if defined(APP_P2P_BENCH_RTT_BRIDGE)
	id->build_flags |= P2P_BUILD_BENCH_RTT_BRIDGE;
#endif
#if defined(CONFIG_DEBUG_OPTIMIZATIONS) || defined(CONFIG_NO_OPTIMIZATIONS)
	id->build_flags |= P2P_BUILD_DEBUG;
#endif
#if defined(CONFIG_NB_TWR_RX_INJECT)
	id->build_flags |= P2P_BUILD_RX_INJECT;
#endif
}

static void handle_get_info(uint8_t seq, size_t body_len)
{
	struct twr_info in;
	struct diag_info d;
	struct radio_ctl_stats rs;
	uint8_t payload[P2P_GET_INFO_LEN];

	if (body_len != 0) {
		send_rsp(P2P_CMD_GET_INFO, seq, P2P_STATUS_BAD_PARAM, NULL, 0);
		return;
	}

	memset(&in, 0, sizeof(in));
	cmd_identity(&in.id);
	in.now_ms = radio_ctl_now_ms();
	in.state = (uint8_t)radio_ctl_state();
	in.modulation = P2P_MODULATION_LORA;
	(void)radio_ctl_get_config(&in.radio); /* zeroed before SET_RADIO_CONFIG */

	diag_snapshot(&d);
	in.err_flags = d.err_flags;
	in.last_err_code = d.last_err_code;
	in.last_err_age_s = d.last_err_age_s;

	radio_ctl_get_stats(&rs);
	in.ctr[P2P_INFO_RADIO_CRC_ERR] = rs.crc_err;
	in.ctr[P2P_INFO_RADIO_HDR_ERR] = rs.hdr_err;
	in.ctr[P2P_INFO_RX_OVERRUN] = rs.rx_overrun;
	in.ctr[P2P_INFO_RX_REARM_FAIL] = d.rx_rearm_fail;
	in.ctr[P2P_INFO_TX_TOTAL] = rs.tx_total;
	in.ctr[P2P_INFO_TX_RADIO_ERR] = d.tx_radio_err;
	in.ctr[P2P_INFO_LINK_CRC_ERR] = uart_link_get_crc_err_count();
	/* Framing errors and RX overruns (diag.c), plus events the TX ring had no room for. */
	in.ctr[P2P_INFO_LINK_ERR] = d.link_err + uart_link_get_tx_drops();
	in.ack_turnaround_last_us = rs.ack_turnaround_last_us;
	in.ack_turnaround_max_us = rs.ack_turnaround_max_us;

	/* The duty ledger has its own lock; never taken inside the core's. */
	in.airtime_ms_last_hour = twr_rt_airtime_ms_last_hour();
	/* The core's counters, tables and the event ring (evt_ring_*, evt_resent). */
	twr_gwc_info(twr_rt_lock(), &in);
	twr_rt_unlock();
	nb_boot_app_record(&in.app_image_len, &in.app_crc32);

	send_rsp(P2P_CMD_GET_INFO, seq, P2P_STATUS_OK, payload, twr_link_enc_info(&in, payload));
}

static void handle_set_radio_config(uint8_t seq, const uint8_t *body, size_t body_len)
{
	struct radio_config cfg;
	enum p2p_status status = twr_link_dec_radio_config(body, body_len, &cfg);

	if (status == P2P_STATUS_OK && radio_ctl_state() == P2P_NB_GATEWAY) {
		/* A radio change is RX_STOP -> SET_RADIO_CONFIG -> TWR_START. */
		status = P2P_STATUS_INVALID_STATE;
	}
	if (status == P2P_STATUS_OK) {
		status = radio_ctl_set_config(&cfg);
	}
	send_rsp(P2P_CMD_SET_RADIO_CONFIG, seq, status, NULL, 0);
}

static void handle_rx_stop(uint8_t seq, size_t body_len)
{
	enum p2p_status status =
		(body_len != 0) ? P2P_STATUS_BAD_PARAM : radio_ctl_rx_stop();

	send_rsp(P2P_CMD_RX_STOP, seq, status, NULL, 0);
}

static void handle_tx_schedule(uint8_t seq, const uint8_t *body, size_t body_len)
{
	if (body_len < P2P_TX_SCHEDULE_HDR_LEN) {
		send_rsp(P2P_CMD_TX_SCHEDULE, seq, P2P_STATUS_BAD_PARAM, NULL, 0);
		return;
	}

	uint8_t tx_id = body[0];
	uint64_t t_ms = sys_get_le64(&body[1]);
	uint8_t len = body[9];

	if (body_len != (size_t)P2P_TX_SCHEDULE_HDR_LEN + len) {
		send_rsp(P2P_CMD_TX_SCHEDULE, seq, P2P_STATUS_BAD_PARAM, NULL, 0);
		return;
	}

	enum p2p_status status =
		radio_ctl_tx_schedule(tx_id, t_ms, &body[P2P_TX_SCHEDULE_HDR_LEN], len);

	if (status == P2P_STATUS_INTERNAL) {
		diag_set_flag(DIAG_FLAG_TX_INTERNAL);
	}
	send_rsp(P2P_CMD_TX_SCHEDULE, seq, status, NULL, 0);
}

static void handle_tx_cancel(uint8_t seq, const uint8_t *body, size_t body_len)
{
	if (body_len != P2P_TX_CANCEL_BODY_LEN) {
		send_rsp(P2P_CMD_TX_CANCEL, seq, P2P_STATUS_BAD_PARAM, NULL, 0);
		return;
	}

	send_rsp(P2P_CMD_TX_CANCEL, seq, radio_ctl_tx_cancel(body[0]), NULL, 0);
}

/* northbridge_update.md §10: the RSP goes out first, then the reboot into the ROM bootloader.
 * Accepted in every state: the update stops the gateway whatever it was doing. */
static void handle_enter_bootloader(uint8_t seq, const uint8_t *body, size_t body_len)
{
	enum p2p_status status = twr_link_dec_enter_bootloader(body, body_len);

	send_rsp(P2P_CMD_ENTER_BOOTLOADER, seq, status, NULL, 0);
	if (status == P2P_STATUS_OK) {
		nb_boot_enter_rom_bootloader();
	}
}

void proto_on_frame(uint8_t type, uint8_t seq, const uint8_t *body, size_t body_len)
{
	switch (type) {
	case P2P_CMD_GET_INFO:
		handle_get_info(seq, body_len);
		break;
	case P2P_CMD_SET_RADIO_CONFIG:
		handle_set_radio_config(seq, body, body_len);
		break;
	case P2P_CMD_RX_STOP:
		handle_rx_stop(seq, body_len);
		break;
	case P2P_CMD_TX_SCHEDULE:
		handle_tx_schedule(seq, body, body_len);
		break;
	case P2P_CMD_TX_CANCEL:
		handle_tx_cancel(seq, body, body_len);
		break;
	case P2P_CMD_ENTER_BOOTLOADER:
		handle_enter_bootloader(seq, body, body_len);
		break;
	default:
		/* TWR_* (twr_cmd.c answers them itself). */
		if (twr_cmd_handle(type, seq, body, body_len)) {
			break;
		}
		/* Unknown command type: still answered under the 0x40|type convention so the
		 * host can correlate via seq. */
		send_rsp(type, seq, P2P_STATUS_UNSUPPORTED, NULL, 0);
		break;
	}
}
```

## src/cmd_dispatch.h
```c
/* SPDX-License-Identifier: Apache-2.0 */
#ifndef APP_CMD_DISPATCH_H_
#define APP_CMD_DISPATCH_H_

#include <stddef.h>
#include <stdint.h>

struct twr_identity;

/* Entry point from uart_link.c: dispatch one decoded, CRC-valid frame and
 * send back its RSP (and, for TX_CANCEL, a matching EVT_TX_DONE) via
 * uart_link_send(). */
void proto_on_frame(uint8_t type, uint8_t seq, const uint8_t *body, size_t body_len);

/* The image's identity as EVT_BOOT and GET_INFO carry it (fw_ver, git_sha, the boot reset
 * cause diag.c holds, build_flags). */
void cmd_identity(struct twr_identity *id);

#endif /* APP_CMD_DISPATCH_H_ */
```

## src/diag.c
```c
/* SPDX-License-Identifier: Apache-2.0
 *
 * Northbridge diagnostics, see diag.h. Written from the radio workqueue, the system
 * workqueue and the main thread, so every field sits under one spinlock; the EVT_LOG
 * itself goes out after the lock is released.
 */
#include "diag.h"
#include "proto.h"
#include "uart_link.h"

#include <stdbool.h>
#include <string.h>
#include <zephyr/kernel.h>

static struct k_spinlock lock;

static uint8_t radio_state = DIAG_RADIO_IDLE;
static uint8_t boot_reset_cause;
static uint32_t err_flags;
static uint32_t rx_rearm_fail;
static uint32_t tx_radio_err;
static uint32_t link_err;
static uint8_t last_err_code;
static int64_t last_err_ms;
static int64_t last_log_ms[DIAG_CODE_COUNT];
static bool log_sent[DIAG_CODE_COUNT];

static const uint32_t code_flag[DIAG_CODE_COUNT] = {
	[DIAG_CODE_RADIO_INIT] = DIAG_FLAG_RADIO_INIT,
	[DIAG_CODE_RX_REARM] = DIAG_FLAG_RX_REARM,
	[DIAG_CODE_TX_RADIO] = DIAG_FLAG_TX_RADIO,
	[DIAG_CODE_LINK_FRAMING] = DIAG_FLAG_LINK_FRAMING,
	[DIAG_CODE_UART_OVERRUN] = DIAG_FLAG_UART_OVERRUN,
};

static void bump(uint32_t *counter)
{
	if (*counter != UINT32_MAX) {
		(*counter)++;
	}
}

void diag_set_boot_reset_cause(uint8_t cause)
{
	k_spinlock_key_t key = k_spin_lock(&lock);

	boot_reset_cause = cause;
	k_spin_unlock(&lock, key);
}

void diag_set_radio_state(enum diag_radio_state state)
{
	k_spinlock_key_t key = k_spin_lock(&lock);

	radio_state = (uint8_t)state;
	k_spin_unlock(&lock, key);
}

enum diag_radio_state diag_radio_state(void)
{
	k_spinlock_key_t key = k_spin_lock(&lock);
	enum diag_radio_state state = (enum diag_radio_state)radio_state;

	k_spin_unlock(&lock, key);
	return state;
}

void diag_set_flag(uint32_t flag)
{
	k_spinlock_key_t key = k_spin_lock(&lock);

	err_flags |= flag;
	k_spin_unlock(&lock, key);
}

size_t diag_encode_log(uint8_t *out, size_t cap, uint8_t level, uint8_t code, const char *detail)
{
	if (cap < 2) {
		return 0;
	}
	size_t n = 0;

	out[n++] = level;
	out[n++] = code;
	if (detail != NULL) {
		size_t len = strlen(detail);

		if (len > cap - n) {
			len = cap - n;
		}
		memcpy(&out[n], detail, len);
		n += len;
	}
	return n;
}

void diag_report(enum diag_code code, const char *detail)
{
	if (code <= DIAG_CODE_NONE || code >= DIAG_CODE_COUNT) {
		return;
	}

	int64_t now = k_uptime_get();
	bool send = false;
	k_spinlock_key_t key = k_spin_lock(&lock);

	err_flags |= code_flag[code];
	switch (code) {
	case DIAG_CODE_RX_REARM:
		bump(&rx_rearm_fail);
		break;
	case DIAG_CODE_TX_RADIO:
		bump(&tx_radio_err);
		break;
	case DIAG_CODE_LINK_FRAMING:
	case DIAG_CODE_UART_OVERRUN:
		bump(&link_err);
		break;
	default:
		break;
	}
	last_err_code = (uint8_t)code;
	last_err_ms = now;
	if (!log_sent[code] || now - last_log_ms[code] >= DIAG_LOG_INTERVAL_MS) {
		log_sent[code] = true;
		last_log_ms[code] = now;
		send = true;
	}
	k_spin_unlock(&lock, key);

	/* A link error is not reported over the link it failed on while it is still failing;
	 * the next EVT_LOG goes out once DIAG_LOG_INTERVAL_MS has passed, and GET_INFO carries
	 * the counter in the meantime. */
	if (send) {
		uint8_t body[2 + 48];
		size_t n = diag_encode_log(body, sizeof(body), DIAG_LEVEL_ERROR, (uint8_t)code,
					   detail);

		uart_link_send_event(P2P_EVT_LOG, body, n);
	}
}

void diag_snapshot(struct diag_info *out)
{
	int64_t now = k_uptime_get();
	k_spinlock_key_t key = k_spin_lock(&lock);

	out->radio_state = radio_state;
	out->boot_reset_cause = boot_reset_cause;
	out->err_flags = err_flags;
	out->rx_rearm_fail = rx_rearm_fail;
	out->tx_radio_err = tx_radio_err;
	out->link_err = link_err;
	out->last_err_code = last_err_code;
	out->last_err_age_s = 0;
	if (last_err_code != DIAG_CODE_NONE) {
		int64_t age = (now - last_err_ms) / 1000;

		out->last_err_age_s = age > (int64_t)UINT32_MAX ? UINT32_MAX : (uint32_t)age;
	}
	k_spin_unlock(&lock, key);
}
```

## src/diag.h
```c
/* SPDX-License-Identifier: Apache-2.0
 *
 * Northbridge diagnostics: the radio state, sticky error flags and error counters GET_INFO
 * carries, and rate-limited EVT_LOG error reports in every build.
 * Spec: proximos-v2 plan/control/radio/northbridge_diagnostics.md §2.
 */
#ifndef APP_DIAG_H_
#define APP_DIAG_H_

#include <stddef.h>
#include <stdint.h>

/* §2.1 radio_state */
enum diag_radio_state {
	DIAG_RADIO_IDLE = 0,
	DIAG_RADIO_RX = 1,
	DIAG_RADIO_TX = 2,
	DIAG_RADIO_ERROR = 3,
};

/* §2.2 EVT_LOG codes, also GET_INFO last_err_code */
enum diag_code {
	DIAG_CODE_NONE = 0,
	DIAG_CODE_RADIO_INIT = 1,
	DIAG_CODE_RX_REARM = 2,
	DIAG_CODE_TX_RADIO = 3,
	DIAG_CODE_LINK_FRAMING = 4,
	DIAG_CODE_UART_OVERRUN = 5,
	DIAG_CODE_STACK = 6,
	DIAG_CODE_COUNT,
};

/* §2.2 EVT_LOG levels */
#define DIAG_LEVEL_ERROR   1
#define DIAG_LEVEL_WARNING 2
#define DIAG_LEVEL_DEBUG   3

/* §2.1 err_flags, sticky since boot */
#define DIAG_FLAG_RADIO_INIT   (1u << 0)
#define DIAG_FLAG_RX_REARM     (1u << 1)
#define DIAG_FLAG_TX_RADIO     (1u << 2)
#define DIAG_FLAG_LINK_FRAMING (1u << 3)
#define DIAG_FLAG_UART_OVERRUN (1u << 4)
#define DIAG_FLAG_TX_INTERNAL  (1u << 5)

/* What GET_INFO reads (the counters saturate at UINT32_MAX). */
struct diag_info {
	uint8_t radio_state; /* enum diag_radio_state, shell only */
	uint8_t boot_reset_cause;
	uint32_t err_flags;
	uint32_t rx_rearm_fail;
	uint32_t tx_radio_err;
	uint32_t link_err;
	uint8_t last_err_code;
	uint32_t last_err_age_s; /* 0 while no error was reported */
};

/* At most one EVT_LOG per code in this many milliseconds (§2.2). */
#define DIAG_LOG_INTERVAL_MS 10000

void diag_set_boot_reset_cause(uint8_t cause);
void diag_set_radio_state(enum diag_radio_state state);
enum diag_radio_state diag_radio_state(void);

/* Record an error: its sticky flag, its counter, the last-error code and time, and an
 * EVT_LOG (level error) unless one with the same code went out within
 * DIAG_LOG_INTERVAL_MS. `detail` is short ASCII, may be NULL. */
void diag_report(enum diag_code code, const char *detail);

/* Set a sticky flag that has no code of its own (DIAG_FLAG_TX_INTERNAL). */
void diag_set_flag(uint32_t flag);

void diag_snapshot(struct diag_info *out);

/* Encode an EVT_LOG body (§2.2): level, code, then `detail` truncated to fit `cap`.
 * Returns its length. Exposed for the ztests. */
size_t diag_encode_log(uint8_t *out, size_t cap, uint8_t level, uint8_t code, const char *detail);

#endif /* APP_DIAG_H_ */
```

## src/hdlc.c
```c
/* SPDX-License-Identifier: Apache-2.0 */
#include "hdlc.h"

#include <string.h>
#include <zephyr/sys/byteorder.h>
#include <zephyr/sys/crc.h>

/* CRC16-CCITT (poly 0x1021, init 0xFFFF, no reflection - aka CRC-16/CCITT-FALSE).
 *
 * Zephyr's naming is the opposite of what it looks like: crc16_ccitt() is
 * the *reflected* variant (CRC-16/KERMIT-family). The non-reflected
 * CCITT-FALSE this link's spec calls for is crc16_itu_t(). Using the
 * wrong one produces a CRC that matches on-device but never matches a
 * reference/host implementation - verified against the CRC-16/CCITT-FALSE
 * test vector in tests/hdlc_framing.
 */
static uint16_t frame_crc16(const uint8_t *data, size_t len)
{
	return crc16_itu_t(0xFFFF, data, len);
}

void hdlc_decoder_init(struct hdlc_decoder *dec)
{
	memset(dec, 0, sizeof(*dec));
}

static enum hdlc_feed_result finish_frame(struct hdlc_decoder *dec, hdlc_frame_cb cb,
					   void *user_data)
{
	size_t len = dec->len;

	dec->len = 0;
	dec->escape = false;

	if (len == 0) {
		/* Two flags in a row (or leading flag) - not an error. */
		return HDLC_FEED_NONE;
	}
	if (len < 4) {
		/* type + seq + crc16 is the minimum possible frame. */
		return HDLC_FEED_TOO_SHORT;
	}

	size_t body_len = len - 4;
	uint16_t crc_rx = sys_get_le16(&dec->buf[len - 2]);
	uint16_t crc_calc = frame_crc16(dec->buf, len - 2);

	if (crc_rx != crc_calc) {
		return HDLC_FEED_CRC_ERROR;
	}

	cb(dec->buf[0], dec->buf[1], &dec->buf[2], body_len, user_data);
	return HDLC_FEED_FRAME;
}

enum hdlc_feed_result hdlc_decoder_feed(struct hdlc_decoder *dec, uint8_t byte,
					 hdlc_frame_cb cb, void *user_data)
{
	if (byte == HDLC_FLAG) {
		enum hdlc_feed_result result = finish_frame(dec, cb, user_data);

		dec->in_frame = true;
		return result;
	}

	if (!dec->in_frame) {
		/* Junk before the first flag (line noise, a stray console
		 * byte) - ignore until framing starts. */
		return HDLC_FEED_NONE;
	}

	if (byte == HDLC_ESC) {
		dec->escape = true;
		return HDLC_FEED_NONE;
	}

	if (dec->escape) {
		byte ^= HDLC_ESC_XOR;
		dec->escape = false;
	}

	if (dec->len >= sizeof(dec->buf)) {
		/* Overflow: drop the whole frame, resync on the next flag. */
		dec->in_frame = false;
		dec->len = 0;
		dec->escape = false;
		return HDLC_FEED_OVERFLOW;
	}

	dec->buf[dec->len++] = byte;
	return HDLC_FEED_NONE;
}

int hdlc_encode(uint8_t type, uint8_t seq, const uint8_t *body, size_t body_len,
		 uint8_t *out, size_t out_size)
{
	if (body_len > P2P_MAX_BODY_LEN) {
		return -1;
	}

	uint8_t payload[2 + P2P_MAX_BODY_LEN + 2];

	payload[0] = type;
	payload[1] = seq;
	memcpy(&payload[2], body, body_len);

	size_t unescaped_len = 2 + body_len;
	uint16_t crc = frame_crc16(payload, unescaped_len);

	sys_put_le16(crc, &payload[unescaped_len]);
	unescaped_len += 2;

	size_t out_len = 0;

	if (out_len >= out_size) {
		return -1;
	}
	out[out_len++] = HDLC_FLAG;

	for (size_t i = 0; i < unescaped_len; i++) {
		uint8_t b = payload[i];

		if (b == HDLC_FLAG || b == HDLC_ESC) {
			if (out_len + 2 > out_size) {
				return -1;
			}
			out[out_len++] = HDLC_ESC;
			out[out_len++] = b ^ HDLC_ESC_XOR;
		} else {
			if (out_len + 1 > out_size) {
				return -1;
			}
			out[out_len++] = b;
		}
	}

	if (out_len >= out_size) {
		return -1;
	}
	out[out_len++] = HDLC_FLAG;

	return (int)out_len;
}
```

## src/hdlc.h
```c
/* SPDX-License-Identifier: Apache-2.0
 *
 * HDLC-style byte-stuffed framing for the P2P host<->modem link.
 * Spec: proximos-v2 plan/system/lora/design.md §3.
 *
 * Frame on the wire: 0x7E | escaped(type|seq|body|crc16) | 0x7E
 * CRC16 (see hdlc.c for the exact algorithm) is computed over the
 * unescaped type|seq|body.
 */
#ifndef APP_HDLC_H_
#define APP_HDLC_H_

#include <stdbool.h>
#include <stddef.h>
#include <stdint.h>

#include "proto.h"

/* Streaming decoder state. Persists across uart_link_poll() calls so a
 * frame split across polls (or UART bytes) reassembles correctly.
 * P2P_MAX_FRAME_LEN is already type+seq+body+crc16 with no flag bytes
 * counted (see proto.h) - the flags are frame delimiters, consumed by
 * hdlc_decoder_feed() and never stored in buf.
 */
struct hdlc_decoder {
	uint8_t buf[P2P_MAX_FRAME_LEN];
	size_t len;
	bool in_frame;
	bool escape;
};

enum hdlc_feed_result {
	HDLC_FEED_NONE = 0,     /* byte consumed, no frame boundary yet */
	HDLC_FEED_FRAME,        /* valid frame decoded and dispatched via cb */
	HDLC_FEED_CRC_ERROR,    /* frame boundary hit, CRC did not match */
	HDLC_FEED_TOO_SHORT,    /* frame boundary hit, fewer than 4 bytes (type+seq+crc16) */
	HDLC_FEED_OVERFLOW,     /* frame exceeded the max length and was discarded */
};

typedef void (*hdlc_frame_cb)(uint8_t type, uint8_t seq, const uint8_t *body,
			       size_t body_len, void *user_data);

void hdlc_decoder_init(struct hdlc_decoder *dec);

/* Feed one raw (still-escaped) byte from the wire. Invokes cb synchronously
 * exactly when the return value is HDLC_FEED_FRAME. */
enum hdlc_feed_result hdlc_decoder_feed(struct hdlc_decoder *dec, uint8_t byte,
					 hdlc_frame_cb cb, void *user_data);

/* Encodes flag | escaped(type|seq|body|crc16) | flag into out[].
 * Returns the encoded length, or -1 if out_size is too small.
 */
int hdlc_encode(uint8_t type, uint8_t seq, const uint8_t *body, size_t body_len,
		 uint8_t *out, size_t out_size);

#endif /* APP_HDLC_H_ */
```

## src/nb_boot.c
```c
/* SPDX-License-Identifier: Apache-2.0
 *
 * The app's side of nbboot (northbridge_update.md §3.1, §10), see nb_boot.h. The layout
 * constants are nbboot's (nbboot/src/nb_app_valid.h); the asserts below tie them to the
 * board dts this image is linked from.
 */
#include "nb_boot.h"
#include "nb_app_valid.h"
#include "uart_link.h"

#include <zephyr/devicetree.h>
#include <zephyr/kernel.h>
#include <zephyr/storage/flash_map.h>
#include <zephyr/sys/barrier.h>
#include <zephyr/sys/reboot.h>

/* The app is linked into slot0, behind the stub, ... */
BUILD_ASSERT(CONFIG_FLASH_BASE_ADDRESS + CONFIG_FLASH_LOAD_OFFSET == NB_APP_ADDR,
	     "app not linked at nbboot's NB_APP_ADDR (dts zephyr,code-partition)");
BUILD_ASSERT(PARTITION_SIZE(slot0_partition) == NB_APP_MAX_LEN, "slot0 size");
/* ... the record is where the stub and the Hub's flasher put it, ... */
BUILD_ASSERT(CONFIG_FLASH_BASE_ADDRESS + PARTITION_OFFSET(app_valid_partition) ==
	     NB_APP_VALID_ADDR, "app_valid partition");
/* ... and the boot request word is not Zephyr's RAM. */
BUILD_ASSERT(DT_REG_ADDR(DT_CHOSEN(zephyr_sram)) + DT_REG_SIZE(DT_CHOSEN(zephyr_sram)) <=
	     NB_BOOT_REQ_ADDR, "sram0 overlaps the boot request word");

/* The RSP is 6 B, but events queued before it go first: a full TX ring is 178 ms of line. */
#define NB_BOOT_DRAIN_MS 250

void nb_boot_app_record(uint32_t *image_len, uint32_t *image_crc32)
{
	struct nb_app_record r;

	if (nb_app_record_parse((const uint8_t *)NB_APP_VALID_ADDR, &r)) {
		*image_len = r.image_len;
		*image_crc32 = r.image_crc32;
	} else {
		*image_len = 0;
		*image_crc32 = 0;
	}
}

void nb_boot_enter_rom_bootloader(void)
{
	/* On a timeout the reboot goes ahead anyway: the Hub then finds the ROM bootloader by
	 * its 0x7F sync instead of by the RSP (northbridge_update.md §3.6). */
	(void)uart_link_tx_drain(NB_BOOT_DRAIN_MS);

	*(volatile uint32_t *)NB_BOOT_REQ_ADDR = NB_BOOT_REQ_MAGIC;
	barrier_dsync_fence_full();
	sys_reboot(SYS_REBOOT_COLD);
}
```

## src/nb_boot.h
```c
/* SPDX-License-Identifier: Apache-2.0
 *
 * The app's side of the update through the Hub (proximos-v2
 * plan/control/radio/northbridge_update.md §3.1, §10): the app_valid record nbboot checked
 * before starting this image, and the way back into the STM32 ROM bootloader.
 */
#ifndef APP_NB_BOOT_H_
#define APP_NB_BOOT_H_

#include <stdint.h>

/* image_len and image_crc32 of the app_valid record (GET_INFO app_image_len, app_crc32);
 * both 0 when the record is not valid. The image itself is not re-checked: nbboot did that. */
void nb_boot_app_record(uint32_t *image_len, uint32_t *image_crc32);

/* ENTER_BOOTLOADER, after its RSP is queued: waits for the UART to send it, writes the boot
 * request word and does a cold reboot; nbboot then jumps to the ROM bootloader. Thread
 * context only. Does not return. */
void nb_boot_enter_rom_bootloader(void);

#endif /* APP_NB_BOOT_H_ */
```
